## CMakeLists.txt
```
cmake_minimum_required(VERSION 3.20.0)

find_package(Zephyr REQUIRED HINTS $ENV{ZEPHYR_BASE})
project(entropy_renewal)

get_filename_component(REPO_ROOT "${CMAKE_CURRENT_SOURCE_DIR}/.." ABSOLUTE)

set(QEAAS_CLIENT_ROOT_VALUE "$ENV{QEAAS_CLIENT_ROOT}")
if(DEFINED QEAAS_CLIENT_ROOT)
    set(QEAAS_CLIENT_ROOT_VALUE "${QEAAS_CLIENT_ROOT}")
endif()
if(NOT QEAAS_CLIENT_ROOT_VALUE)
    set(QEAAS_CLIENT_ROOT_VALUE "${REPO_ROOT}/../qeaas_esp32_client")
endif()
get_filename_component(QEAAS_CLIENT_ROOT_VALUE "${QEAAS_CLIENT_ROOT_VALUE}" ABSOLUTE)
set(QEAAS_WOLFSSL_ROOT "${QEAAS_CLIENT_ROOT_VALUE}/wolfssl")

if(NOT EXISTS "${QEAAS_WOLFSSL_ROOT}/include/config-wolfssl-libcoap.h")
    message(FATAL_ERROR
        "Could not find QEaaS wolfSSL client headers at ${QEAAS_WOLFSSL_ROOT}. "
        "Set QEAAS_CLIENT_ROOT to a QEaaS ESP32 client checkout.")
endif()

set(DTLS_SERVER_IP_VALUE "$ENV{DTLS_IP}")
set(DTLS_SERVER_PORT_VALUE "$ENV{DTLS_PORT}")
set(DTLS_ENTROPY_BYTES_VALUE "$ENV{DTLS_ENTROPY_BYTES}")
set(WIFI_SSID_VALUE "$ENV{WIFI_SSID}")
set(WIFI_PASS_VALUE "$ENV{WIFI_PASS}")
set(WOLFSSL_GROUPS_VALUE "$ENV{WOLFSSL_GROUPS}")
set(WOLFSSL_SIG_VALUE "$ENV{WOLFSSL_SIG}")
set(RENEWAL_ITERATIONS_VALUE "$ENV{RENEWAL_ITERATIONS}")
set(RENEWAL_WARMUP_VALUE "$ENV{RENEWAL_WARMUP}")
set(RENEWAL_INTER_HANDSHAKE_MS_VALUE "$ENV{RENEWAL_INTER_HANDSHAKE_MS}")
set(RENEWAL_NETWORK_INJECT_EVERY_VALUE "$ENV{RENEWAL_NETWORK_INJECT_EVERY}")

if("${DTLS_SERVER_IP_VALUE}" STREQUAL "")
    set(DTLS_SERVER_IP_VALUE "$ENV{COAP_IP}")
endif()
if("${DTLS_SERVER_PORT_VALUE}" STREQUAL "")
    set(DTLS_SERVER_PORT_VALUE "$ENV{COAP_PORT}")
endif()
if("${WOLFSSL_GROUPS_VALUE}" STREQUAL "")
    set(WOLFSSL_GROUPS_VALUE "$ENV{COAP_WOLFSSL_GROUPS}")
endif()
if("${WOLFSSL_SIG_VALUE}" STREQUAL "")
    set(WOLFSSL_SIG_VALUE "$ENV{COAP_WOLFSSL_SIG}")
endif()
if("${WOLFSSL_GROUPS_VALUE}" STREQUAL "")
    set(WOLFSSL_GROUPS_VALUE "P-256")
endif()
if("${WOLFSSL_SIG_VALUE}" STREQUAL "")
    set(WOLFSSL_SIG_VALUE "ECDSA_P256")
endif()
if("${DTLS_SERVER_IP_VALUE}" STREQUAL "")
    set(DTLS_SERVER_IP_VALUE "192.168.1.136")
endif()
if("${DTLS_SERVER_PORT_VALUE}" STREQUAL "")
    set(DTLS_SERVER_PORT_VALUE "5684")
endif()
if("${DTLS_ENTROPY_BYTES_VALUE}" STREQUAL "")
    set(DTLS_ENTROPY_BYTES_VALUE "32")
endif()
if("${WIFI_SSID_VALUE}" STREQUAL "")
    set(WIFI_SSID_VALUE "WIFI_SSID_NOT_SET")
endif()
if("${WIFI_PASS_VALUE}" STREQUAL "")
    set(WIFI_PASS_VALUE "WIFI_PASS_NOT_SET")
endif()
if("${RENEWAL_ITERATIONS_VALUE}" STREQUAL "")
    set(RENEWAL_ITERATIONS_VALUE "50")
endif()
if("${RENEWAL_WARMUP_VALUE}" STREQUAL "")
    set(RENEWAL_WARMUP_VALUE "3")
endif()
if("${RENEWAL_INTER_HANDSHAKE_MS_VALUE}" STREQUAL "")
    set(RENEWAL_INTER_HANDSHAKE_MS_VALUE "1000")
endif()
if("${RENEWAL_NETWORK_INJECT_EVERY_VALUE}" STREQUAL "")
    set(RENEWAL_NETWORK_INJECT_EVERY_VALUE "1")
endif()

zephyr_include_directories(
    include
    ${QEAAS_WOLFSSL_ROOT}/include
)

target_sources(app PRIVATE
    src/main.c
    src/renewal_rng_wrap.c
    ${QEAAS_WOLFSSL_ROOT}/src/wifi.c
)

target_include_directories(app PRIVATE
    include
    ${QEAAS_WOLFSSL_ROOT}/include
)

# Linker wrapping keeps wolfSSL v5.8.2-stable unmodified while counting the
# RNG-output bytes returned by the wolfCrypt API.
target_link_options(app PRIVATE
    -Wl,--wrap=wc_RNG_GenerateBlock
    -Wl,--wrap=wc_RNG_GenerateByte
)

target_compile_definitions(app PRIVATE
    DTLS_SERVER_IP="${DTLS_SERVER_IP_VALUE}"
    DTLS_SERVER_PORT=${DTLS_SERVER_PORT_VALUE}
    DTLS_ENTROPY_BYTES=${DTLS_ENTROPY_BYTES_VALUE}
    WOLFSSL_GROUP_NAME="${WOLFSSL_GROUPS_VALUE}"
    WIFI_SSID="${WIFI_SSID_VALUE}"
    WIFI_PASS="${WIFI_PASS_VALUE}"
    RENEWAL_ITERATIONS=${RENEWAL_ITERATIONS_VALUE}
    RENEWAL_WARMUP=${RENEWAL_WARMUP_VALUE}
    RENEWAL_INTER_HANDSHAKE_MS=${RENEWAL_INTER_HANDSHAKE_MS_VALUE}
    RENEWAL_NETWORK_INJECT_EVERY=${RENEWAL_NETWORK_INJECT_EVERY_VALUE}
)

if(DEFINED ENV{RENEWAL_ENABLE_NETWORK_INJECTION})
    target_compile_definitions(app PRIVATE RENEWAL_ENABLE_NETWORK_INJECTION=1)
endif()

if(DEFINED ENV{RENEWAL_DISABLE_LOCAL_REFILL_AFTER_BOOTSTRAP})
    target_compile_definitions(app PRIVATE RENEWAL_DISABLE_LOCAL_REFILL_AFTER_BOOTSTRAP=1)
endif()

if(DEFINED ENV{SKIP_PEER_VERIFY})
    target_compile_definitions(app PRIVATE SKIP_PEER_VERIFY=1)
    set(_VERIFY_PEER "OFF")
else()
    set(_VERIFY_PEER "ON")
endif()

if(WOLFSSL_GROUPS_VALUE)
    if(WOLFSSL_GROUPS_VALUE MATCHES "ML_KEM_1024")
        set(_WOLFSSL_ALGO "MLKEM1024")
    elseif(WOLFSSL_GROUPS_VALUE MATCHES "ML_KEM_768")
        set(_WOLFSSL_ALGO "MLKEM768")
    elseif(WOLFSSL_GROUPS_VALUE MATCHES "ML_KEM_512")
        set(_WOLFSSL_ALGO "MLKEM512")
    elseif(WOLFSSL_GROUPS_VALUE MATCHES "X25519")
        set(_WOLFSSL_ALGO "X25519")
    else()
        set(_WOLFSSL_ALGO "ECDHE_P256")
    endif()
else()
    set(_WOLFSSL_ALGO "ECDHE_P256")
endif()

zephyr_compile_definitions(WOLFSSL_ALGO_${_WOLFSSL_ALGO}=1)

if(WOLFSSL_SIG_VALUE MATCHES "ML_DSA_44")
    set(_WOLFSSL_SIG "MLDSA44")
else()
    set(_WOLFSSL_SIG "ECDSA_P256")
endif()
zephyr_compile_definitions(WOLFSSL_SIG_${_WOLFSSL_SIG}=1)

message(STATUS "...............................................")
message(STATUS "Embedded renewal benchmark")
message(STATUS "QEaaS client root:       ${QEAAS_CLIENT_ROOT_VALUE}")
message(STATUS "DTLS server:             ${DTLS_SERVER_IP_VALUE}:${DTLS_SERVER_PORT_VALUE}")
message(STATUS "DTLS entropy bytes:      ${DTLS_ENTROPY_BYTES_VALUE}")
message(STATUS "wolfSSL group string:    ${WOLFSSL_GROUPS_VALUE}")
message(STATUS "wolfSSL key exchange:    ${_WOLFSSL_ALGO}")
message(STATUS "wolfSSL signature:       ${_WOLFSSL_SIG}")
message(STATUS "Verify peer cert:        ${_VERIFY_PEER}")
message(STATUS "Iterations/warmup:       ${RENEWAL_ITERATIONS_VALUE}/${RENEWAL_WARMUP_VALUE}")
message(STATUS "Inter-handshake delay:   ${RENEWAL_INTER_HANDSHAKE_MS_VALUE} ms")
message(STATUS "Wi-Fi network:           ${WIFI_SSID_VALUE}")
message(STATUS "...............................................")
```

## west.yml
```
manifest:
  defaults:
    remote: zephyrproject

  remotes:
    - name: fjblanco
      url-base: https://github.com/fj-blanco
    - name: zephyrproject
      url-base: https://github.com/zephyrproject-rtos
    - name: wolfssl
      url-base: https://github.com/wolfssl

  projects:
    # Same Zephyr fork and commit used by the successful QEaaS ESP32 client.
    - name: zephyr
      remote: fjblanco
      repo-path: zephyr
      revision: 028d1947465c192509694cc1b8b5ef6bc7e1bad1
      path: zephyr
      import:
        name-allowlist:
          - cmsis
          - hal_espressif
          - hal_xtensa
          - mbedtls
    - name: wolfssl
      remote: wolfssl
      repo-path: wolfssl
      revision: v5.8.2-stable
      path: modules/crypto/wolfssl

  self:
    path: .
```

## prj.conf
```kconfig
# ESP32 embedded entropy-renewal benchmark.
#
# This mirrors the known-good QEaaS wolfSSL client configuration and adds only
# the instrumentation required for renewal measurements.

CONFIG_NEWLIB_LIBC=y
CONFIG_POSIX_API=y
CONFIG_XOPEN_STREAMS=y

# Memory tuned for ML-KEM-512 / ML-DSA-44 DTLS 1.3 on ESP32.
CONFIG_MAIN_STACK_SIZE=12288
CONFIG_SYSTEM_WORKQUEUE_STACK_SIZE=1024
CONFIG_IDLE_STACK_SIZE=1024
CONFIG_HEAP_MEM_POOL_SIZE=107520

CONFIG_LOG=y
CONFIG_LOG_DEFAULT_LEVEL=2
CONFIG_PRINTK=y
CONFIG_EARLY_CONSOLE=y
CONFIG_ASSERT=n
CONFIG_SYS_HEAP_RUNTIME_STATS=y

CONFIG_SERIAL=y
CONFIG_UART_CONSOLE=y
CONFIG_CONSOLE=y
CONFIG_GPIO=y

CONFIG_NETWORKING=y
CONFIG_NET_SOCKETS=y
CONFIG_NET_IPV4=y
CONFIG_NET_IPV6=n
CONFIG_NET_UDP=y
CONFIG_NET_TCP=n
CONFIG_NET_DHCPV4=y
CONFIG_NET_L2_ETHERNET=y
CONFIG_NET_L2_ETHERNET_MGMT=y
CONFIG_NET_MGMT=y
CONFIG_NET_MGMT_EVENT=y

CONFIG_WIFI=y
CONFIG_NET_L2_WIFI_MGMT=y

# MbedTLS is required by the ESP32 Wi-Fi driver only. The DTLS application
# backend is wolfSSL.
CONFIG_MBEDTLS=y
CONFIG_MBEDTLS_BUILTIN=y
CONFIG_MBEDTLS_ENABLE_HEAP=y
CONFIG_MBEDTLS_HEAP_SIZE=4096
CONFIG_MBEDTLS_USER_CONFIG_ENABLE=y
CONFIG_MBEDTLS_USER_CONFIG_FILE="config-mbedtls-wifi.h"
CONFIG_MBEDTLS_TLS_VERSION_1_2=n
CONFIG_MBEDTLS_DTLS=n
CONFIG_MBEDTLS_KEY_EXCHANGE_ALL_ENABLED=n
CONFIG_MBEDTLS_KEY_EXCHANGE_PSK_ENABLED=n
CONFIG_MBEDTLS_KEY_EXCHANGE_DHE_PSK_ENABLED=n
CONFIG_MBEDTLS_KEY_EXCHANGE_RSA_PSK_ENABLED=n
CONFIG_MBEDTLS_KEY_EXCHANGE_RSA_ENABLED=n
CONFIG_MBEDTLS_KEY_EXCHANGE_DHE_RSA_ENABLED=n
CONFIG_MBEDTLS_KEY_EXCHANGE_ECJPAKE_ENABLED=n
CONFIG_MBEDTLS_PEM_CERTIFICATE_FORMAT=n
CONFIG_MBEDTLS_SERVER_NAME_INDICATION=n
CONFIG_MBEDTLS_SSL_EXTENDED_MASTER_SECRET=n
CONFIG_MBEDTLS_SSL_DTLS_CONNECTION_ID=n
CONFIG_MBEDTLS_GENPRIME_ENABLED=n
CONFIG_MBEDTLS_DEBUG=n
CONFIG_MBEDTLS_ECP_DP_SECP256R1_ENABLED=y

# Application entropy and TLS stack.
CONFIG_ENTROPY_GENERATOR=y
CONFIG_ENTROPY_BLAKE2S=y
CONFIG_WOLFSSL=y
CONFIG_WOLFSSL_SETTINGS_FILE="config-wolfssl-libcoap.h"

CONFIG_SHELL=n
CONFIG_PM=n
CONFIG_SMP=n
```

## boards/esp32_devkitc_wroom_procpu.conf
```kconfig
# ESP32-DevKitC WROOM board configuration.

CONFIG_WIFI=y
CONFIG_WIFI_ESP32=y
CONFIG_ESP32_WIFI_STA_AUTO_DHCPV4=y
CONFIG_ESP32_USE_UNSUPPORTED_REVISION=y
```

## boards/esp32_devkitc_wroom_procpu.overlay
```dts
&wifi {
	status = "okay";
};

/ {
	chosen {
		zephyr,entropy = &entropy_blake2s;
	};

	entropy_blake2s: entropy-blake2s-pool {
		compatible = "zephyr,entropy-blake2s-pool";
		hardware-device = <&trng0>;
		status = "okay";
	};
};
```

## src/main.c
```c
/*
 * Embedded entropy-renewal benchmark for ESP32 + Zephyr + wolfSSL.
 *
 * Each iteration creates one fresh DTLS 1.3 session and records:
 * - wolfSSL RNG-output bytes requested through wc_RNG_GenerateBlock/Byte
 * - credited BLAKE2s pool balance before and after the DTLS exchange
 * - local hardware refill bytes, accepted network bytes, and pool-debit bytes
 * - timing and RNG-wrapper cycle counters
 *
 * The application protocol is deliberately minimal: after the DTLS handshake,
 * the client writes "GET <N>\n" and expects N raw entropy bytes in reply.
 */

#include <errno.h>
#include <stdbool.h>
#include <stdio.h>
#include <stdlib.h>
#include <string.h>

#include <zephyr/device.h>
#include <zephyr/drivers/entropy.h>
#include <zephyr/drivers/entropy_blake2s_renewal.h>
#include <zephyr/kernel.h>
#include <zephyr/net/socket.h>
#include <zephyr/sys/mem_stats.h>
#include <zephyr/sys/sys_heap.h>
#include <zephyr/sys/util.h>

#include <wolfssl/ssl.h>
#include <wolfssl/version.h>
#include <wolfssl/wolfcrypt/settings.h>

#include "renewal_rng_wrap.h"
#include "wifi.h"

#ifndef SKIP_PEER_VERIFY
#include "ca_certs.h"
#endif

#ifdef CONFIG_SYS_HEAP_RUNTIME_STATS
extern struct k_heap _system_heap;
#endif

#ifndef DTLS_SERVER_IP
#define DTLS_SERVER_IP "192.168.1.136"
#endif

#ifndef DTLS_SERVER_PORT
#define DTLS_SERVER_PORT 5684
#endif

#ifndef DTLS_ENTROPY_BYTES
#define DTLS_ENTROPY_BYTES 32
#endif

#ifndef WOLFSSL_GROUP_NAME
#define WOLFSSL_GROUP_NAME "P-256"
#endif

#ifndef RENEWAL_ITERATIONS
#define RENEWAL_ITERATIONS 50
#endif

#ifndef RENEWAL_WARMUP
#define RENEWAL_WARMUP 3
#endif

#ifndef RENEWAL_INTER_HANDSHAKE_MS
#define RENEWAL_INTER_HANDSHAKE_MS 1000
#endif

#ifndef RENEWAL_NETWORK_INJECT_EVERY
#define RENEWAL_NETWORK_INJECT_EVERY 1
#endif

#define RESPONSE_BUFFER_SIZE     768
#define ENTROPY_PAYLOAD_MAX      256
#define DTLS_REQUEST_BUFFER_SIZE 32
#define DTLS_SOCKET_TIMEOUT_S    30
#define DTLS_MTU                 1400

#define RENEWAL_META(key, value) printf("[RENEWAL_META] %s,%s\n", (key), (value))

static uint8_t response_data[RESPONSE_BUFFER_SIZE];
static size_t response_data_len;

static inline uint32_t get_cycles(void)
{
	return k_cycle_get_32();
}

static inline uint32_t cycles_to_us(uint32_t start, uint32_t end)
{
	return k_cyc_to_us_floor32(end - start);
}

static void report_heap_stats(const char *label)
{
#ifdef CONFIG_SYS_HEAP_RUNTIME_STATS
	struct sys_memory_stats stats;
	char key[48];
	char value[32];

	if (sys_heap_runtime_stats_get(&_system_heap.heap, &stats) == 0) {
		snprintf(key, sizeof(key), "heap_free_%s", label);
		snprintf(value, sizeof(value), "%zu", stats.free_bytes);
		RENEWAL_META(key, value);

		snprintf(key, sizeof(key), "heap_used_%s", label);
		snprintf(value, sizeof(value), "%zu", stats.allocated_bytes);
		RENEWAL_META(key, value);

		snprintf(key, sizeof(key), "heap_peak_%s", label);
		snprintf(value, sizeof(value), "%zu", stats.max_allocated_bytes);
		RENEWAL_META(key, value);
	}
#else
	ARG_UNUSED(label);
#endif
}

static int setup_destination_address(struct sockaddr_in *dst, const char *host, uint16_t port)
{
	memset(dst, 0, sizeof(*dst));
	dst->sin_family = AF_INET;
	dst->sin_port = htons(port);

	if (inet_pton(AF_INET, host, &dst->sin_addr) <= 0) {
		printf("[RENEWAL_ERR] inet_pton,%s\n", host);
		return -EINVAL;
	}

	return 0;
}

static int create_connected_udp_socket(const struct sockaddr_in *dst)
{
	struct timeval timeout = {
		.tv_sec = DTLS_SOCKET_TIMEOUT_S,
		.tv_usec = 0,
	};
	int fd;

	fd = zsock_socket(AF_INET, SOCK_DGRAM, IPPROTO_UDP);
	if (fd < 0) {
		printf("[RENEWAL_ERR] socket,%d\n", errno);
		return -errno;
	}

	(void)zsock_setsockopt(fd, SOL_SOCKET, SO_RCVTIMEO, &timeout, sizeof(timeout));
	(void)zsock_setsockopt(fd, SOL_SOCKET, SO_SNDTIMEO, &timeout, sizeof(timeout));

	if (zsock_connect(fd, (const struct sockaddr *)dst, sizeof(*dst)) < 0) {
		int err = errno;

		printf("[RENEWAL_ERR] udp_connect,%d\n", err);
		(void)zsock_close(fd);
		return -err;
	}

	return fd;
}

static WOLFSSL_CTX *create_dtls_ctx(void)
{
	WOLFSSL_CTX *ctx;

	ctx = wolfSSL_CTX_new(wolfDTLSv1_3_client_method());
	if (ctx == NULL) {
		printf("[RENEWAL_ERR] wolfssl_ctx_new\n");
		return NULL;
	}

	if (wolfSSL_CTX_set_cipher_list(ctx, "TLS13-AES128-GCM-SHA256") != WOLFSSL_SUCCESS) {
		printf("[RENEWAL_ERR] wolfssl_cipher_list\n");
		wolfSSL_CTX_free(ctx);
		return NULL;
	}

	if (wolfSSL_CTX_set1_groups_list(ctx, WOLFSSL_GROUP_NAME) != WOLFSSL_SUCCESS) {
		printf("[RENEWAL_ERR] wolfssl_group,%s\n", WOLFSSL_GROUP_NAME);
		wolfSSL_CTX_free(ctx);
		return NULL;
	}

#ifdef SKIP_PEER_VERIFY
	wolfSSL_CTX_set_verify(ctx, SSL_VERIFY_NONE, NULL);
#else
	wolfSSL_CTX_set_verify(ctx, SSL_VERIFY_PEER, NULL);
#if defined(WOLFSSL_SIG_MLDSA44)
	if (wolfSSL_CTX_load_verify_buffer(ctx, (const unsigned char *)ca_cert_mldsa44_pem,
					   sizeof(ca_cert_mldsa44_pem),
					   SSL_FILETYPE_PEM) != WOLFSSL_SUCCESS) {
		printf("[RENEWAL_ERR] load_ca_mldsa44\n");
		wolfSSL_CTX_free(ctx);
		return NULL;
	}
#else
	if (wolfSSL_CTX_load_verify_buffer(ctx, (const unsigned char *)ca_cert_ecc_pem,
					   sizeof(ca_cert_ecc_pem),
					   SSL_FILETYPE_PEM) != WOLFSSL_SUCCESS) {
		printf("[RENEWAL_ERR] load_ca_ecc\n");
		wolfSSL_CTX_free(ctx);
		return NULL;
	}
#endif
#endif

	return ctx;
}

static int configure_dtls_session(WOLFSSL *ssl, int fd)
{
	if (wolfSSL_set_fd(ssl, fd) != WOLFSSL_SUCCESS) {
		return -EIO;
	}

	if (wolfSSL_dtls_set_mtu(ssl, DTLS_MTU) != WOLFSSL_SUCCESS) {
		return -EIO;
	}

#if defined(WOLFSSL_ALGO_MLKEM512) || defined(WOLFSSL_ALGO_MLKEM768) ||                            \
	defined(WOLFSSL_ALGO_MLKEM1024)
	if (wolfSSL_NoKeyShares(ssl) != WOLFSSL_SUCCESS) {
		return -EIO;
	}
#endif

	return 0;
}

static int dtls_request_entropy(WOLFSSL *ssl)
{
	char request[DTLS_REQUEST_BUFFER_SIZE];
	int request_len;
	int ret;

	response_data_len = 0;
	memset(response_data, 0, sizeof(response_data));

	ret = wolfSSL_connect(ssl);
	if (ret != WOLFSSL_SUCCESS) {
		printf("[RENEWAL_ERR] wolfssl_connect,%d\n", wolfSSL_get_error(ssl, ret));
		return -ECONNABORTED;
	}

	request_len = snprintf(request, sizeof(request), "GET %d\n", DTLS_ENTROPY_BYTES);
	if (request_len <= 0 || request_len >= (int)sizeof(request)) {
		return -EINVAL;
	}

	ret = wolfSSL_write(ssl, request, request_len);
	if (ret != request_len) {
		printf("[RENEWAL_ERR] wolfssl_write,%d\n", wolfSSL_get_error(ssl, ret));
		return -EIO;
	}

	while (response_data_len < DTLS_ENTROPY_BYTES &&
	       response_data_len < sizeof(response_data)) {
		ret = wolfSSL_read(ssl, response_data + response_data_len,
				   sizeof(response_data) - response_data_len);
		if (ret <= 0) {
			printf("[RENEWAL_ERR] wolfssl_read,%d\n", wolfSSL_get_error(ssl, ret));
			return response_data_len > 0 ? 0 : -ENODATA;
		}
		response_data_len += (size_t)ret;
	}

	return 0;
}

static int maybe_mix_network_entropy(const struct device *entropy_dev, int iter,
				     size_t *accepted_bytes)
{
#ifdef RENEWAL_ENABLE_NETWORK_INJECTION
	size_t payload_len;
	int ret;
#endif

	*accepted_bytes = 0;

#ifndef RENEWAL_ENABLE_NETWORK_INJECTION
	ARG_UNUSED(entropy_dev);
	ARG_UNUSED(iter);
	return 0;
#else
	if (RENEWAL_NETWORK_INJECT_EVERY <= 0 || (iter % RENEWAL_NETWORK_INJECT_EVERY) != 0) {
		return 0;
	}

	payload_len = MIN(response_data_len, (size_t)DTLS_ENTROPY_BYTES);
	payload_len = MIN(payload_len, (size_t)ENTROPY_PAYLOAD_MAX);
	if (payload_len == 0) {
		printf("[RENEWAL_WARN] empty_entropy_payload,%d\n", iter);
		return -ENODATA;
	}

	ret = entropy_add_entropy(entropy_dev, response_data, payload_len, payload_len * 8);
	if (ret == 0) {
		*accepted_bytes = payload_len;
	}
	return ret;
#endif
}

static void emit_algorithm_metadata(void)
{
#if defined(WOLFSSL_ALGO_MLKEM1024)
	RENEWAL_META("key_exchange", "ML-KEM-1024");
#elif defined(WOLFSSL_ALGO_MLKEM768)
	RENEWAL_META("key_exchange", "ML-KEM-768");
#elif defined(WOLFSSL_ALGO_MLKEM512)
	RENEWAL_META("key_exchange", "ML-KEM-512");
#elif defined(WOLFSSL_ALGO_X25519)
	RENEWAL_META("key_exchange", "X25519");
#elif defined(WOLFSSL_ALGO_ECDHE_P256)
	RENEWAL_META("key_exchange", "ECDHE-P256");
#else
	RENEWAL_META("key_exchange", "unknown");
#endif

#if defined(WOLFSSL_SIG_MLDSA44)
	RENEWAL_META("signature", "ML-DSA-44");
#else
	RENEWAL_META("signature", "ECDSA-P256");
#endif
}

static int run_one_iteration(const struct device *entropy_dev, const struct sockaddr_in *dst,
			     int iter, bool measured)
{
	struct entropy_blake2s_renewal_stats pre;
	struct entropy_blake2s_renewal_stats post;
	struct renewal_rng_stats rng;
	WOLFSSL_CTX *ctx = NULL;
	WOLFSSL *ssl = NULL;
	uint32_t start;
	uint32_t end;
	size_t accepted_net_bytes = 0;
	int fd = -1;
	int ret = -EIO;

	ctx = create_dtls_ctx();
	if (ctx == NULL) {
		return -ENOMEM;
	}

	fd = create_connected_udp_socket(dst);
	if (fd < 0) {
		ret = fd;
		goto out;
	}

	ssl = wolfSSL_new(ctx);
	if (ssl == NULL) {
		ret = -ENOMEM;
		goto out;
	}

	ret = configure_dtls_session(ssl, fd);
	if (ret != 0) {
		printf("[RENEWAL_ERR] wolfssl_config,%d\n", ret);
		goto out;
	}

	memset(&pre, 0, sizeof(pre));
	memset(&post, 0, sizeof(post));
	memset(&rng, 0, sizeof(rng));

	renewal_rng_reset();
	(void)entropy_blake2s_renewal_snapshot(&pre);
	start = get_cycles();

	ret = dtls_request_entropy(ssl);
	if (ret == 0) {
		ret = maybe_mix_network_entropy(entropy_dev, iter, &accepted_net_bytes);
	}

	end = get_cycles();
	(void)entropy_blake2s_renewal_snapshot(&post);
	renewal_rng_snapshot(&rng);

	if (measured) {
		printf("[RENEWAL_ITER] %d,%d,%u,%zu,%zu,"
		       "%llu,%llu,%llu,%llu,"
		       "%llu,%llu,%llu,%llu,%llu,%llu,%u,%u,"
		       "%llu,%llu,%llu,%llu,%llu\n",
		       iter, ret, cycles_to_us(start, end), response_data_len, accepted_net_bytes,
		       (unsigned long long)rng.block_calls, (unsigned long long)rng.block_bytes,
		       (unsigned long long)rng.byte_calls, (unsigned long long)rng.byte_bytes,
		       (unsigned long long)(post.total_hw_bytes - pre.total_hw_bytes),
		       (unsigned long long)(post.total_external_bytes - pre.total_external_bytes),
		       (unsigned long long)(post.total_pool_debit_bytes -
					    pre.total_pool_debit_bytes),
		       (unsigned long long)(post.total_thread_get_bytes -
					    pre.total_thread_get_bytes),
		       (unsigned long long)(post.total_isr_get_bytes - pre.total_isr_get_bytes),
		       (unsigned long long)(post.total_fast_refill_bytes -
					    pre.total_fast_refill_bytes),
		       pre.credited_pool_bits, post.credited_pool_bits,
		       (unsigned long long)rng.block_cycles, (unsigned long long)rng.byte_cycles,
		       (unsigned long long)rng.errors, (unsigned long long)pre.timestamp_us,
		       (unsigned long long)post.timestamp_us);
	}

out:
	if (ssl != NULL) {
		wolfSSL_shutdown(ssl);
		wolfSSL_free(ssl);
	}
	if (fd >= 0) {
		(void)zsock_close(fd);
	}
	if (ctx != NULL) {
		wolfSSL_CTX_free(ctx);
	}
	return ret;
}

static int run_benchmark(const struct device *entropy_dev)
{
	struct sockaddr_in dst;
	int ret;

	ret = wolfSSL_Init();
	if (ret != WOLFSSL_SUCCESS) {
		printf("[RENEWAL_ERR] wolfssl_init,%d\n", ret);
		return -EIO;
	}

	ret = setup_destination_address(&dst, DTLS_SERVER_IP, DTLS_SERVER_PORT);
	if (ret != 0) {
		goto out_cleanup;
	}

	wifi_init(NULL);
	ret = connect_to_wifi();
	if (ret < 0 || wait_for_wifi_connection() < 0) {
		printf("[RENEWAL_ERR] wifi_connect,%d\n", ret);
		ret = -ENOTCONN;
		goto out_cleanup;
	}
	k_sleep(K_MSEC(1000));

	for (int i = 0; i < RENEWAL_WARMUP; i++) {
		(void)run_one_iteration(entropy_dev, &dst, i, false);
		k_sleep(K_MSEC(RENEWAL_INTER_HANDSHAKE_MS));
	}

	printf("[RENEWAL_HEADER] iter,ret,elapsed_us,response_bytes,"
	       "accepted_net_bytes,rng_block_calls,rng_block_bytes,"
	       "rng_byte_calls,rng_byte_bytes,local_hw_bytes,external_bytes,"
	       "pool_debit_bytes,thread_get_bytes,isr_get_bytes,"
	       "fast_refill_bytes,pool_credit_bits_pre,pool_credit_bits_post,"
	       "rng_block_cycles,rng_byte_cycles,rng_errors,"
	       "pool_timestamp_us_pre,pool_timestamp_us_post\n");

	for (int i = 0; i < RENEWAL_ITERATIONS; i++) {
		ret = run_one_iteration(entropy_dev, &dst, i, true);
		if (ret != 0) {
			printf("[RENEWAL_WARN] iteration_failed,%d,%d\n", i, ret);
		}
		if (!wifi_is_connected() && wifi_reconnect() != 0) {
			printf("[RENEWAL_ERR] wifi_reconnect_failed,%d\n", i);
			break;
		}
		k_sleep(K_MSEC(RENEWAL_INTER_HANDSHAKE_MS));
	}

	ret = 0;

out_cleanup:
	wifi_disconnect();
	wolfSSL_Cleanup();
	return ret;
}

int main(void)
{
	const struct device *entropy_dev;
	struct entropy_blake2s_renewal_stats boot_stats;
	char value[64];

	printf("\n[RENEWAL_START]\n");
	k_sleep(K_SECONDS(5));

	entropy_dev = DEVICE_DT_GET(DT_CHOSEN(zephyr_entropy));
	if (!device_is_ready(entropy_dev)) {
		printf("[RENEWAL_ERR] entropy_device_not_ready\n");
		return EXIT_FAILURE;
	}

	RENEWAL_META("board", "esp32_devkitc_wroom");
	RENEWAL_META("entropy_driver", entropy_dev->name);
	RENEWAL_META("schema_version", "3");
	RENEWAL_META("transport", "dtls13_udp");
	RENEWAL_META("application_protocol", "raw_entropy_request");
	snprintf(value, sizeof(value), "%s:%d", DTLS_SERVER_IP, DTLS_SERVER_PORT);
	RENEWAL_META("dtls_server", value);
	snprintf(value, sizeof(value), "%d", DTLS_ENTROPY_BYTES);
	RENEWAL_META("dtls_entropy_bytes", value);
	RENEWAL_META("wolfssl_group_name", WOLFSSL_GROUP_NAME);
	RENEWAL_META("wolfssl_version", LIBWOLFSSL_VERSION_STRING);
	RENEWAL_META("cert_verify",
#ifdef SKIP_PEER_VERIFY
		     "disabled"
#else
		     "enabled"
#endif
	);
	emit_algorithm_metadata();

	snprintf(value, sizeof(value), "%d", RENEWAL_ITERATIONS);
	RENEWAL_META("iterations", value);
	snprintf(value, sizeof(value), "%d", RENEWAL_WARMUP);
	RENEWAL_META("warmup", value);
	snprintf(value, sizeof(value), "%d", RENEWAL_INTER_HANDSHAKE_MS);
	RENEWAL_META("inter_handshake_ms", value);
#ifdef RENEWAL_ENABLE_NETWORK_INJECTION
	RENEWAL_META("network_injection", "enabled");
	RENEWAL_META("network_payload_parser", "raw_binary");
	RENEWAL_META("network_entropy_credit_bits_per_byte", "8");
#else
	RENEWAL_META("network_injection", "disabled");
#endif

#ifdef RENEWAL_DISABLE_LOCAL_REFILL_AFTER_BOOTSTRAP
	entropy_blake2s_renewal_set_hw_refill_enabled(false);
	RENEWAL_META("local_hw_refill_after_bootstrap", "disabled");
#else
	RENEWAL_META("local_hw_refill_after_bootstrap", "enabled");
#endif

	if (entropy_blake2s_renewal_snapshot(&boot_stats) == 0) {
		snprintf(value, sizeof(value), "%u", boot_stats.credited_pool_bits);
		RENEWAL_META("boot_pool_credit_bits", value);
	}

	report_heap_stats("boot");
	(void)run_benchmark(entropy_dev);
	report_heap_stats("final");

	printf("[RENEWAL_END]\n");
	return EXIT_SUCCESS;
}
```

## include/config-mbedtls-wifi.h
```c
/*
 * Minimal mbedTLS configuration for the ESP32 Wi-Fi driver. The benchmark
 * application itself uses wolfSSL directly for DTLS.
 */

#ifndef CONFIG_MBEDTLS_WIFI_H
#define CONFIG_MBEDTLS_WIFI_H

#ifndef MBEDTLS_AES_C
#define MBEDTLS_AES_C
#endif

#if defined(MBEDTLS_CCM_C)
#ifndef MBEDTLS_CCM_GCM_CAN_AES
#define MBEDTLS_CCM_GCM_CAN_AES
#endif
#endif

#ifndef MBEDTLS_MD_CAN_SHA256
#define MBEDTLS_MD_CAN_SHA256
#endif

#endif /* CONFIG_MBEDTLS_WIFI_H */
```

## src/renewal_rng_wrap.c
```c
#include "renewal_rng_wrap.h"

#include <string.h>
#include <zephyr/kernel.h>
#include <wolfssl/wolfcrypt/random.h>

static struct k_spinlock rng_lock;
static struct renewal_rng_stats rng_stats;

void renewal_rng_reset(void)
{
	k_spinlock_key_t key = k_spin_lock(&rng_lock);

	memset(&rng_stats, 0, sizeof(rng_stats));
	k_spin_unlock(&rng_lock, key);
}

void renewal_rng_snapshot(struct renewal_rng_stats *out)
{
	k_spinlock_key_t key;

	if (out == NULL) {
		return;
	}

	key = k_spin_lock(&rng_lock);
	*out = rng_stats;
	k_spin_unlock(&rng_lock, key);
}

static void record_block_result(word32 sz, uint32_t cycles, int ret)
{
	k_spinlock_key_t key = k_spin_lock(&rng_lock);

	rng_stats.block_calls++;
	rng_stats.block_cycles += cycles;
	if (ret == 0) {
		rng_stats.block_bytes += sz;
	} else {
		rng_stats.errors++;
	}

	k_spin_unlock(&rng_lock, key);
}

static void record_byte_result(uint32_t cycles, int ret)
{
	k_spinlock_key_t key = k_spin_lock(&rng_lock);

	rng_stats.byte_calls++;
	rng_stats.byte_cycles += cycles;
	if (ret == 0) {
		rng_stats.byte_bytes++;
	} else {
		rng_stats.errors++;
	}

	k_spin_unlock(&rng_lock, key);
}

int __real_wc_RNG_GenerateBlock(WC_RNG *rng, byte *output, word32 sz);
int __wrap_wc_RNG_GenerateBlock(WC_RNG *rng, byte *output, word32 sz)
{
	uint32_t start = k_cycle_get_32();
	int ret = __real_wc_RNG_GenerateBlock(rng, output, sz);
	uint32_t end = k_cycle_get_32();

	record_block_result(sz, end - start, ret);
	return ret;
}

int __real_wc_RNG_GenerateByte(WC_RNG *rng, byte *b);
int __wrap_wc_RNG_GenerateByte(WC_RNG *rng, byte *b)
{
	uint32_t start = k_cycle_get_32();
	int ret = __real_wc_RNG_GenerateByte(rng, b);
	uint32_t end = k_cycle_get_32();

	record_byte_result(end - start, ret);
	return ret;
}
```

## src/renewal_rng_wrap.h
```c
#ifndef RENEWAL_RNG_WRAP_H
#define RENEWAL_RNG_WRAP_H

#include <stdint.h>

struct renewal_rng_stats {
	uint64_t block_calls;
	uint64_t block_bytes;
	uint64_t block_cycles;
	uint64_t byte_calls;
	uint64_t byte_bytes;
	uint64_t byte_cycles;
	uint64_t errors;
};

void renewal_rng_reset(void);
void renewal_rng_snapshot(struct renewal_rng_stats *out);

#endif /* RENEWAL_RNG_WRAP_H */
```
