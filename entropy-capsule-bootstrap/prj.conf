## CMakeLists.txt
```
cmake_minimum_required(VERSION 3.20.0)

find_package(Zephyr REQUIRED HINTS $ENV{ZEPHYR_BASE})
project(entropy_capsule_bootstrap)

set(WIFI_SSID_VALUE $ENV{WIFI_SSID})
set(WIFI_PASS_VALUE $ENV{WIFI_PASS})
set(TEB_SERVER_IP_VALUE $ENV{TEB_SERVER_IP})
set(TEB_SERVER_PORT_VALUE $ENV{TEB_SERVER_PORT})
set(TEB_DEVICE_ID_VALUE $ENV{TEB_DEVICE_ID})
set(TEB_PUF_BYTES_VALUE $ENV{TEB_PUF_BYTES})
set(TEB_PUF_DUMP_HEX_VALUE $ENV{TEB_PUF_DUMP_HEX})
set(TEB_DISABLE_LOCAL_REFILL_VALUE $ENV{TEB_DISABLE_LOCAL_REFILL})
set(TEB_PROFILE_VALUE $ENV{TEB_PROFILE})

if(DEFINED WIFI_SSID)
    set(WIFI_SSID_VALUE ${WIFI_SSID})
endif()
if(DEFINED WIFI_PASS)
    set(WIFI_PASS_VALUE ${WIFI_PASS})
endif()
if(DEFINED TEB_SERVER_IP)
    set(TEB_SERVER_IP_VALUE ${TEB_SERVER_IP})
endif()
if(DEFINED TEB_SERVER_PORT)
    set(TEB_SERVER_PORT_VALUE ${TEB_SERVER_PORT})
endif()
if(DEFINED TEB_DEVICE_ID)
    set(TEB_DEVICE_ID_VALUE ${TEB_DEVICE_ID})
endif()
if(DEFINED TEB_PUF_BYTES)
    set(TEB_PUF_BYTES_VALUE ${TEB_PUF_BYTES})
endif()
if(DEFINED TEB_PUF_DUMP_HEX)
    set(TEB_PUF_DUMP_HEX_VALUE ${TEB_PUF_DUMP_HEX})
endif()
if(DEFINED TEB_DISABLE_LOCAL_REFILL)
    set(TEB_DISABLE_LOCAL_REFILL_VALUE ${TEB_DISABLE_LOCAL_REFILL})
endif()
if(DEFINED TEB_PROFILE)
    set(TEB_PROFILE_VALUE ${TEB_PROFILE})
endif()

if(NOT WIFI_SSID_VALUE)
    set(WIFI_SSID_VALUE "WIFI_SSID_NOT_SET")
endif()
if(NOT WIFI_PASS_VALUE)
    set(WIFI_PASS_VALUE "WIFI_PASS_NOT_SET")
endif()
if(NOT TEB_SERVER_IP_VALUE)
    set(TEB_SERVER_IP_VALUE "192.168.1.136")
endif()
if(NOT TEB_SERVER_PORT_VALUE)
    set(TEB_SERVER_PORT_VALUE "6767")
endif()
if(NOT TEB_DEVICE_ID_VALUE)
    set(TEB_DEVICE_ID_VALUE "0x4553503332544542")
endif()
if(NOT TEB_PUF_BYTES_VALUE)
    set(TEB_PUF_BYTES_VALUE "4096")
endif()
if(NOT TEB_PUF_DUMP_HEX_VALUE)
    set(TEB_PUF_DUMP_HEX_VALUE "0")
endif()
if(NOT TEB_DISABLE_LOCAL_REFILL_VALUE)
    set(TEB_DISABLE_LOCAL_REFILL_VALUE "1")
endif()
if(NOT TEB_PROFILE_VALUE)
    set(TEB_PROFILE_VALUE "2")
endif()

zephyr_include_directories(include)
target_include_directories(app PRIVATE ${CMAKE_CURRENT_SOURCE_DIR}/include)

target_sources(app PRIVATE
    src/main.c
    src/teb_crypto.c
    src/teb_puf.c
    src/teb_protocol.c
    src/wifi.c
)

target_compile_definitions(app PRIVATE
    WIFI_SSID="${WIFI_SSID_VALUE}"
    WIFI_PASS="${WIFI_PASS_VALUE}"
    TEB_SERVER_IP="${TEB_SERVER_IP_VALUE}"
    TEB_SERVER_PORT=${TEB_SERVER_PORT_VALUE}
    TEB_DEVICE_ID=${TEB_DEVICE_ID_VALUE}ULL
    TEB_PUF_BYTES=${TEB_PUF_BYTES_VALUE}
    TEB_PUF_DUMP_HEX=${TEB_PUF_DUMP_HEX_VALUE}
    TEB_DISABLE_LOCAL_REFILL=${TEB_DISABLE_LOCAL_REFILL_VALUE}
    TEB_SELECTED_PROFILE=${TEB_PROFILE_VALUE}
)

message(STATUS "...............................................")
message(STATUS "Asymmetric Entropy Capsule Bootstrap")
message(STATUS "  WiFi SSID:       ${WIFI_SSID_VALUE}")
message(STATUS "  Server:          ${TEB_SERVER_IP_VALUE}:${TEB_SERVER_PORT_VALUE}")
message(STATUS "  Device ID:       ${TEB_DEVICE_ID_VALUE}")
message(STATUS "  SRAM PUF bytes:  ${TEB_PUF_BYTES_VALUE}")
message(STATUS "  PUF raw dump:    ${TEB_PUF_DUMP_HEX_VALUE}")
message(STATUS "  Disable refill:  ${TEB_DISABLE_LOCAL_REFILL_VALUE}")
message(STATUS "  Capsule profile: ${TEB_PROFILE_VALUE}")
message(STATUS "...............................................")
```

## west.yml
```
manifest:
  defaults:
    remote: zephyrproject

  remotes:
    - name: fjblanco
      url-base: https://github.com/fj-blanco
    - name: zephyrproject
      url-base: https://github.com/zephyrproject-rtos
    - name: wolfssl
      url-base: https://github.com/wolfssl

  projects:
    - name: zephyr
      remote: fjblanco
      repo-path: zephyr
      revision: 028d1947465c192509694cc1b8b5ef6bc7e1bad1
      path: zephyr
      import:
        name-allowlist:
          - cmsis
          - hal_espressif
          - hal_xtensa
          - mbedtls
    - name: wolfssl
      remote: wolfssl
      repo-path: wolfssl
      revision: v5.8.2-stable
      path: modules/crypto/wolfssl

  self:
    path: .
```

## prj.conf
```kconfig
# Asymmetric entropy capsule bootstrap.

CONFIG_NEWLIB_LIBC=y
CONFIG_POSIX_API=y
CONFIG_XOPEN_STREAMS=y

CONFIG_MAIN_STACK_SIZE=12288
CONFIG_SYSTEM_WORKQUEUE_STACK_SIZE=1024
CONFIG_IDLE_STACK_SIZE=1024
CONFIG_HEAP_MEM_POOL_SIZE=98304

CONFIG_LOG=y
CONFIG_LOG_DEFAULT_LEVEL=2
CONFIG_PRINTK=y
CONFIG_EARLY_CONSOLE=y
CONFIG_ASSERT=n
CONFIG_SYS_HEAP_RUNTIME_STATS=y

CONFIG_SERIAL=y
CONFIG_UART_CONSOLE=y
CONFIG_CONSOLE=y
CONFIG_GPIO=y

CONFIG_NETWORKING=y
CONFIG_NET_SOCKETS=y
CONFIG_NET_IPV4=y
CONFIG_NET_IPV4_FRAGMENT=y
CONFIG_NET_IPV4_FRAGMENT_MAX_PKT=4
CONFIG_NET_IPV6=n
CONFIG_NET_UDP=y
CONFIG_NET_TCP=n
CONFIG_NET_DHCPV4=y
CONFIG_NET_L2_ETHERNET=y
CONFIG_NET_L2_ETHERNET_MGMT=y
CONFIG_NET_MGMT=y
CONFIG_NET_MGMT_EVENT=y
CONFIG_NET_PKT_RX_COUNT=18
CONFIG_NET_BUF_RX_COUNT=48

CONFIG_WIFI=y
CONFIG_NET_L2_WIFI_MGMT=y

CONFIG_MBEDTLS=y
CONFIG_MBEDTLS_BUILTIN=y
CONFIG_MBEDTLS_ENABLE_HEAP=y
CONFIG_MBEDTLS_HEAP_SIZE=4096
CONFIG_MBEDTLS_USER_CONFIG_ENABLE=y
CONFIG_MBEDTLS_USER_CONFIG_FILE="config-mbedtls-wifi.h"
CONFIG_MBEDTLS_TLS_VERSION_1_2=n
CONFIG_MBEDTLS_DTLS=n
CONFIG_MBEDTLS_KEY_EXCHANGE_ALL_ENABLED=n
CONFIG_MBEDTLS_KEY_EXCHANGE_PSK_ENABLED=n
CONFIG_MBEDTLS_KEY_EXCHANGE_DHE_PSK_ENABLED=n
CONFIG_MBEDTLS_KEY_EXCHANGE_RSA_PSK_ENABLED=n
CONFIG_MBEDTLS_KEY_EXCHANGE_RSA_ENABLED=n
CONFIG_MBEDTLS_KEY_EXCHANGE_DHE_RSA_ENABLED=n
CONFIG_MBEDTLS_KEY_EXCHANGE_ECJPAKE_ENABLED=n
CONFIG_MBEDTLS_PEM_CERTIFICATE_FORMAT=n
CONFIG_MBEDTLS_SERVER_NAME_INDICATION=n
CONFIG_MBEDTLS_SSL_EXTENDED_MASTER_SECRET=n
CONFIG_MBEDTLS_SSL_DTLS_CONNECTION_ID=n
CONFIG_MBEDTLS_GENPRIME_ENABLED=n
CONFIG_MBEDTLS_DEBUG=n
CONFIG_MBEDTLS_ECP_DP_SECP256R1_ENABLED=y

CONFIG_ENTROPY_GENERATOR=y
CONFIG_ENTROPY_BLAKE2S=y

CONFIG_WOLFSSL=y
CONFIG_WOLFSSL_SETTINGS_FILE="config-wolfssl-teb.h"

CONFIG_SHELL=n
CONFIG_PM=n
CONFIG_SMP=n
```

## boards/esp32_devkitc_wroom_procpu.conf
```kconfig
# ESP32-DevKitC WROOM board configuration.

CONFIG_WIFI=y
CONFIG_WIFI_ESP32=y
CONFIG_ESP32_WIFI_STA_AUTO_DHCPV4=n
CONFIG_ESP32_USE_UNSUPPORTED_REVISION=y
```

## boards/esp32_devkitc_wroom_procpu.overlay
```dts
&wifi {
	status = "okay";
};

/ {
	chosen {
		zephyr,entropy = &entropy_blake2s;
	};

	entropy_blake2s: entropy-blake2s-pool {
		compatible = "zephyr,entropy-blake2s-pool";
		hardware-device = <&trng0>;
		status = "okay";
	};
};
```

## src/main.c
```c
#include <errno.h>
#include <stdbool.h>
#include <stdio.h>
#include <string.h>

#include <zephyr/device.h>
#include <zephyr/drivers/entropy.h>
#include <zephyr/drivers/entropy_blake2s_renewal.h>
#include <zephyr/kernel.h>
#include <zephyr/net/socket.h>
#include <zephyr/sys/mem_stats.h>
#include <zephyr/sys/sys_heap.h>

#include "teb_crypto.h"
#include "teb_pq_client_keys.h"
#include "teb_protocol.h"
#include "teb_puf.h"
#include "wifi.h"

#ifdef CONFIG_SYS_HEAP_RUNTIME_STATS
extern struct k_heap _system_heap;
#endif

#ifndef TEB_SERVER_IP
#define TEB_SERVER_IP "192.168.1.136"
#endif

#ifndef TEB_SERVER_PORT
#define TEB_SERVER_PORT 6767
#endif

#ifndef TEB_DEVICE_ID
#define TEB_DEVICE_ID 0x4553503332544542ULL
#endif

#define TEB_CAPSULE_CREDIT_BITS 128U
#define TEB_POST_IPV4_SETTLE_MS 1000U

#if TEB_SELECTED_PROFILE == TEB_PROFILE_DEV_ED25519_PUF_BEACON
static const uint8_t gateway_ed25519_pub[TEB_ED25519_PUB_SIZE] = {
	0x91, 0xb5, 0x57, 0x29, 0xfd, 0x6d, 0x88, 0x1d, 0xf8, 0xdc, 0x43,
	0xee, 0x86, 0x03, 0x28, 0x0b, 0x95, 0x46, 0xe8, 0x75, 0xfb, 0x18,
	0x3e, 0x53, 0x3d, 0x0f, 0xa5, 0xe9, 0xb5, 0xd3, 0xeb, 0x1d};
#endif

struct retained_counter {
	uint32_t magic;
	uint32_t value;
	uint32_t check;
};

__attribute__((section(".noinit.teb_counter"), aligned(4),
	       used)) static volatile struct retained_counter retained_boot_counter;

#define TEB_COUNTER_MAGIC 0x54454243U

static uint32_t next_boot_counter(void)
{
	uint32_t value;

	if (retained_boot_counter.magic != TEB_COUNTER_MAGIC ||
	    retained_boot_counter.check != (retained_boot_counter.value ^ TEB_COUNTER_MAGIC)) {
		value = 1;
	} else {
		value = retained_boot_counter.value + 1U;
	}

	retained_boot_counter.magic = TEB_COUNTER_MAGIC;
	retained_boot_counter.value = value;
	retained_boot_counter.check = value ^ TEB_COUNTER_MAGIC;

	return value;
}

static void report_heap(const char *label)
{
#ifdef CONFIG_SYS_HEAP_RUNTIME_STATS
	struct sys_memory_stats stats;

	if (sys_heap_runtime_stats_get(&_system_heap.heap, &stats) == 0) {
		printf("[TEB_META] heap_free_%s,%zu\n", label, stats.free_bytes);
		printf("[TEB_META] heap_used_%s,%zu\n", label, stats.allocated_bytes);
		printf("[TEB_META] heap_peak_%s,%zu\n", label, stats.max_allocated_bytes);
	}
#else
	ARG_UNUSED(label);
#endif
}

static int setup_destination(struct sockaddr_in *dst)
{
	memset(dst, 0, sizeof(*dst));
	dst->sin_family = AF_INET;
	dst->sin_port = htons(TEB_SERVER_PORT);

	if (inet_pton(AF_INET, TEB_SERVER_IP, &dst->sin_addr) <= 0) {
		return -EINVAL;
	}

	return 0;
}

struct teb_exchange_metrics {
	uint32_t exchange_ms;
	uint32_t send_us;
	uint32_t wait_ms;
};

static int request_capsule(const uint8_t hello[TEB_HELLO_LEN], uint8_t capsule[TEB_CAPSULE_LEN],
			   struct teb_exchange_metrics *metrics)
{
	struct sockaddr_in dst;
	struct timeval timeout = {
		.tv_sec = 10,
		.tv_usec = 0,
	};
	int fd;
	int ret;
	uint32_t exchange_start_ms;
	uint32_t send_start_cycles;
	uint32_t send_end_cycles;
	uint32_t wait_start_ms;
	uint32_t recv_end_ms;

	ret = setup_destination(&dst);
	if (ret < 0) {
		return ret;
	}

	fd = zsock_socket(AF_INET, SOCK_DGRAM, IPPROTO_UDP);
	if (fd < 0) {
		return -errno;
	}

	(void)zsock_setsockopt(fd, SOL_SOCKET, SO_RCVTIMEO, &timeout, sizeof(timeout));
	(void)zsock_setsockopt(fd, SOL_SOCKET, SO_SNDTIMEO, &timeout, sizeof(timeout));

	printf("[TEB_NET] connect,%s:%d\n", TEB_SERVER_IP, TEB_SERVER_PORT);
	ret = zsock_connect(fd, (const struct sockaddr *)&dst, sizeof(dst));
	if (ret < 0) {
		int err = errno;

		(void)zsock_close(fd);
		return -err;
	}

	printf("[TEB_NET] send_hello,%u\n", TEB_HELLO_LEN);
	exchange_start_ms = k_uptime_get_32();
	send_start_cycles = k_cycle_get_32();
	ret = zsock_send(fd, hello, TEB_HELLO_LEN, 0);
	send_end_cycles = k_cycle_get_32();
	if (ret != TEB_HELLO_LEN) {
		int err = errno;

		(void)zsock_close(fd);
		return ret < 0 ? -err : -EIO;
	}

	printf("[TEB_NET] recv_capsule_wait,%u\n", TEB_CAPSULE_LEN);
	struct zsock_pollfd pfd = {
		.fd = fd,
		.events = ZSOCK_POLLIN,
	};

	wait_start_ms = k_uptime_get_32();
	ret = zsock_poll(&pfd, 1, 10000);
	if (ret == 0) {
		(void)zsock_close(fd);
		return -ETIMEDOUT;
	}
	if (ret < 0) {
		int err = errno;

		(void)zsock_close(fd);
		return -err;
	}

	ret = zsock_recv(fd, capsule, TEB_CAPSULE_LEN, ZSOCK_MSG_DONTWAIT);
	if (ret != TEB_CAPSULE_LEN) {
		int err = errno;

		(void)zsock_close(fd);
		return ret < 0 ? -err : -EMSGSIZE;
	}
	recv_end_ms = k_uptime_get_32();

	if (metrics != NULL) {
		metrics->exchange_ms = recv_end_ms - exchange_start_ms;
		metrics->send_us = k_cyc_to_us_floor32(send_end_cycles - send_start_cycles);
		metrics->wait_ms = recv_end_ms - wait_start_ms;
	}
	printf("[TEB_METRIC] capsule_exchange_ms,%u\n", recv_end_ms - exchange_start_ms);
	printf("[TEB_METRIC] hello_send_us,%u\n",
	       k_cyc_to_us_floor32(send_end_cycles - send_start_cycles));
	printf("[TEB_METRIC] capsule_wait_ms,%u\n", recv_end_ms - wait_start_ms);

	(void)zsock_close(fd);
	return 0;
}

static int accept_capsule(const struct device *entropy_dev, const uint8_t hello[TEB_HELLO_LEN],
			  const struct teb_hello_fields *hello_fields,
			  const struct teb_puf_sample *puf, const uint8_t capsule[TEB_CAPSULE_LEN])
{
	struct teb_capsule_fields fields;
	uint8_t hello_hash[TEB_HASH_SIZE];
	uint8_t ikm[TEB_HASH_SIZE * 2 + TEB_MLKEM512_SHARED_SECRET_SIZE];
	uint8_t salt[TEB_HASH_SIZE * 2];
	uint8_t seed[TEB_BOOT_SEED_SIZE];
	uint8_t pq_shared_secret[TEB_MLKEM512_SHARED_SECRET_SIZE];
	uint8_t pq_ciphertext_hash[TEB_HASH_SIZE];
#if TEB_SELECTED_PROFILE == TEB_PROFILE_DEV_ED25519_PUF_BEACON
	static const uint8_t info[] = "TEB-PUF-BEACON-v1";
#else
	static const uint8_t info[] = "TEB-PQ-MLKEM512-MLDSA44-v1";
#endif
	uint32_t start;
	uint32_t end;
	int ret;

	ret = teb_parse_capsule(capsule, TEB_CAPSULE_LEN, &fields);
	if (ret < 0) {
		printf("[TEB_ERR] parse_capsule,%d\n", ret);
		return ret;
	}

	if (fields.profile != TEB_SELECTED_PROFILE) {
		printf("[TEB_ERR] profile,%u\n", fields.profile);
		return -EPROTONOSUPPORT;
	}

	if (fields.device_id != hello_fields->device_id ||
	    fields.boot_counter != hello_fields->boot_counter) {
		printf("[TEB_ERR] capsule_binding\n");
		return -EACCES;
	}

	ret = teb_sha256(hello, TEB_HELLO_LEN, hello_hash);
	if (ret != 0) {
		return ret;
	}

	if (memcmp(hello_hash, fields.hello_hash, TEB_HASH_SIZE) != 0) {
		printf("[TEB_ERR] hello_hash_mismatch\n");
		return -EACCES;
	}

	start = k_cycle_get_32();
#if TEB_SELECTED_PROFILE == TEB_PROFILE_DEV_ED25519_PUF_BEACON
	ret = teb_verify_ed25519(gateway_ed25519_pub, capsule, TEB_CAPSULE_SIGNED_LEN,
				 fields.signature);
#else
	ret = teb_verify_mldsa44(teb_mldsa44_public_key, capsule, TEB_CAPSULE_SIGNED_LEN,
				 fields.signature);
#endif
	end = k_cycle_get_32();
	printf("[TEB_METRIC] verify_us,%u\n", k_cyc_to_us_floor32(end - start));
	if (ret != 0) {
		printf("[TEB_ERR] signature,%d\n", ret);
		return ret;
	}

#if TEB_SELECTED_PROFILE == TEB_PROFILE_PQ_MLKEM512_MLDSA44
	start = k_cycle_get_32();
	ret = teb_mlkem512_decapsulate(teb_mlkem512_private_key, fields.kem_ciphertext,
				       pq_shared_secret);
	end = k_cycle_get_32();
	printf("[TEB_METRIC] kem_decaps_us,%u\n", k_cyc_to_us_floor32(end - start));
	if (ret != 0) {
		printf("[TEB_ERR] mlkem_decaps,%d\n", ret);
		return ret;
	}

	ret = teb_sha256(fields.kem_ciphertext, TEB_MLKEM512_CIPHERTEXT_SIZE, pq_ciphertext_hash);
	if (ret != 0) {
		return ret;
	}
#else
	memcpy(pq_shared_secret, fields.beacon, TEB_BEACON_SIZE);
	ret = teb_sha256(fields.beacon, TEB_BEACON_SIZE, pq_ciphertext_hash);
	if (ret != 0) {
		return ret;
	}
#endif

	memcpy(ikm, puf->sram_secret, TEB_HASH_SIZE);
	memcpy(ikm + TEB_HASH_SIZE, puf->timing_secret, TEB_HASH_SIZE);
	memcpy(ikm + TEB_HASH_SIZE * 2, pq_shared_secret, TEB_MLKEM512_SHARED_SECRET_SIZE);
	memcpy(salt, pq_ciphertext_hash, TEB_HASH_SIZE);
	memcpy(salt + TEB_HASH_SIZE, fields.hello_hash, TEB_HASH_SIZE);

	start = k_cycle_get_32();
	ret = teb_hkdf_sha256(ikm, sizeof(ikm), salt, sizeof(salt), info, sizeof(info) - 1, seed,
			      sizeof(seed));
	end = k_cycle_get_32();
	printf("[TEB_METRIC] hkdf_us,%u\n", k_cyc_to_us_floor32(end - start));
	if (ret != 0) {
		printf("[TEB_ERR] hkdf,%d\n", ret);
		return ret;
	}

	start = k_cycle_get_32();
	ret = entropy_add_entropy(entropy_dev, seed, sizeof(seed), TEB_CAPSULE_CREDIT_BITS);
	end = k_cycle_get_32();
	printf("[TEB_METRIC] entropy_add_us,%u\n", k_cyc_to_us_floor32(end - start));
	if (ret != 0) {
		printf("[TEB_ERR] entropy_add,%d\n", ret);
		return ret;
	}

	printf("[TEB_META] capsule_input_bytes,%zu\n", sizeof(seed));
	printf("[TEB_META] capsule_credit_bits,%u\n", TEB_CAPSULE_CREDIT_BITS);
	printf("[TEB_META] gateway_time_ms,%llu\n", (unsigned long long)fields.gateway_time_ms);
	printf("[TEB_META] gateway_sequence,%u\n", fields.sequence);
	teb_print_hex("[TEB_SEED_COMMIT] ", seed, sizeof(seed));

	memset(ikm, 0, sizeof(ikm));
	memset(pq_shared_secret, 0, sizeof(pq_shared_secret));
	memset(seed, 0, sizeof(seed));
	return 0;
}

int main(void)
{
	const struct device *entropy_dev;
	struct teb_puf_sample puf;
	struct teb_hello_fields hello_fields;
	uint8_t hello[TEB_HELLO_LEN];
	uint8_t capsule[TEB_CAPSULE_LEN];
	struct entropy_blake2s_renewal_stats stats;
	struct teb_exchange_metrics exchange_metrics;
	uint32_t reset_ms = k_uptime_get_32();
	uint32_t phase_start_ms;
	uint32_t phase_end_ms;
	uint32_t processing_start_cycles;
	uint32_t processing_end_cycles;
	uint32_t boot_counter;
	int ret;

	printf("\n========================================\n");
	printf("Asymmetric Entropy Capsule Bootstrap\n");
	printf("Profile: %s\n", TEB_PROFILE_NAME);
	printf("Server: %s:%d\n", TEB_SERVER_IP, TEB_SERVER_PORT);
	printf("========================================\n");
	printf("[TEB_META] bootstrap_state,unseeded\n");

	entropy_dev = DEVICE_DT_GET(DT_CHOSEN(zephyr_entropy));
	if (!device_is_ready(entropy_dev)) {
		printf("[TEB_ERR] entropy_not_ready\n");
		return 1;
	}

	boot_counter = next_boot_counter();

#if TEB_DISABLE_LOCAL_REFILL
	entropy_blake2s_renewal_set_hw_refill_enabled(false);
	ret = entropy_blake2s_renewal_discard_credit();
	if (ret != 0) {
		printf("[TEB_ERR] discard_local_credit,%d\n", ret);
		return 1;
	}
	printf("[TEB_META] local_hw_refill,disabled_after_init\n");
	printf("[TEB_META] local_credit,discarded_for_capsule_only_benchmark\n");
#else
	printf("[TEB_META] local_hw_refill,enabled\n");
#endif

	teb_puf_capture(&puf);
	teb_print_hex("[TEB_PUF] sram_commitment,", puf.sram_commitment, TEB_HASH_SIZE);
	teb_print_hex("[TEB_PUF] timing_commitment,", puf.timing_commitment, TEB_HASH_SIZE);
	printf("[TEB_PUF] sram_ones,%u\n", puf.sram_ones);
	printf("[TEB_PUF] sram_transitions,%u\n", puf.sram_transitions);
	printf("[TEB_PUF] timing_min_delta,%u\n", puf.timing_min_delta);
	printf("[TEB_PUF] timing_max_delta,%u\n", puf.timing_max_delta);
	printf("[TEB_PUF] timing_sum_delta,%llu\n", (unsigned long long)puf.timing_sum_delta);

	memset(&hello_fields, 0, sizeof(hello_fields));
	hello_fields.device_id = TEB_DEVICE_ID;
	hello_fields.boot_counter = boot_counter;
	hello_fields.uptime_ms = k_uptime_get_32();
	memcpy(hello_fields.sram_commitment, puf.sram_commitment, TEB_HASH_SIZE);
	memcpy(hello_fields.timing_commitment, puf.timing_commitment, TEB_HASH_SIZE);
	teb_build_hello(hello, &hello_fields);

	printf("[TEB_META] device_id,0x%llx\n", (unsigned long long)hello_fields.device_id);
	printf("[TEB_META] boot_counter,%u\n", hello_fields.boot_counter);
	report_heap("before_wifi");
	printf("[TEB_METRIC] pre_wifi_ms,%u\n", k_uptime_get_32() - reset_ms);

	wifi_set_event_logging(true);
	wifi_init(NULL);
	phase_start_ms = k_uptime_get_32();
	ret = connect_to_wifi();
	phase_end_ms = k_uptime_get_32();
	printf("[TEB_METRIC] wifi_association_ms,%u\n", phase_end_ms - phase_start_ms);
	if (ret != 0) {
		printf("[TEB_ERR] wifi,%d\n", ret);
		printf("[TEB_META] bootstrap_state,failed_unseeded\n");
		return 1;
	}
	phase_start_ms = k_uptime_get_32();
	ret = start_dhcp();
	if (ret != 0) {
		printf("[TEB_ERR] dhcp_start,%d\n", ret);
		printf("[TEB_META] bootstrap_state,failed_unseeded\n");
		return 1;
	}
	ret = wait_for_ipv4_address();
	phase_end_ms = k_uptime_get_32();
	printf("[TEB_METRIC] dhcp_ms,%u\n", phase_end_ms - phase_start_ms);
	if (ret != 0) {
		printf("[TEB_ERR] ipv4,%d\n", ret);
		printf("[TEB_META] bootstrap_state,failed_unseeded\n");
		return 1;
	}
	printf("[TEB_METRIC] post_ipv4_settle_ms,%u\n", TEB_POST_IPV4_SETTLE_MS);
	k_sleep(K_MSEC(TEB_POST_IPV4_SETTLE_MS));

	report_heap("before_capsule");
	printf("[TEB_META] bootstrap_state,waiting_capsule\n");

	memset(&exchange_metrics, 0, sizeof(exchange_metrics));
	ret = request_capsule(hello, capsule, &exchange_metrics);
	if (ret != 0) {
		printf("[TEB_ERR] request_capsule,%d\n", ret);
		printf("[TEB_META] bootstrap_state,failed_unseeded\n");
		return 1;
	}

	processing_start_cycles = k_cycle_get_32();
	ret = accept_capsule(entropy_dev, hello, &hello_fields, &puf, capsule);
	processing_end_cycles = k_cycle_get_32();
	printf("[TEB_METRIC] capsule_processing_us,%u\n",
	       k_cyc_to_us_floor32(processing_end_cycles - processing_start_cycles));
	if (ret != 0) {
		printf("[TEB_META] bootstrap_state,failed_unseeded\n");
		printf("[TEB_RESULT] failed,%d\n", ret);
		return 1;
	}
	printf("[TEB_METRIC] time_to_seed_ms,%u\n", k_uptime_get_32() - reset_ms);
	printf("[TEB_META] bootstrap_state,capsule_ready\n");

	if (entropy_blake2s_renewal_snapshot(&stats) == 0) {
		printf("[TEB_POOL] credited_bits,%u\n", stats.credited_pool_bits);
		printf("[TEB_POOL] external_bytes,%llu\n",
		       (unsigned long long)stats.total_external_bytes);
		printf("[TEB_POOL] hw_bytes,%llu\n", (unsigned long long)stats.total_hw_bytes);
	}

	report_heap("after_capsule");
	printf("[TEB_RESULT] seeded\n");

	return 0;
}
```

## include/config-mbedtls-wifi.h
```c
#ifndef CONFIG_MBEDTLS_WIFI_H
#define CONFIG_MBEDTLS_WIFI_H

#define MBEDTLS_AES_C
#define MBEDTLS_CIPHER_C
#define MBEDTLS_CTR_DRBG_C
#define MBEDTLS_ENTROPY_C
#define MBEDTLS_PLATFORM_C
#define MBEDTLS_SHA256_C

#endif /* CONFIG_MBEDTLS_WIFI_H */
```

## include/config-wolfssl-teb.h
```c
#ifndef WOLFSSL_SETTINGS_H
#define WOLFSSL_SETTINGS_H

#ifdef __cplusplus
extern "C" {
#endif

#ifndef WOLFSSL_USER_SETTINGS
#define WOLFSSL_USER_SETTINGS
#endif

#ifndef WOLFSSL_ZEPHYR
#define WOLFSSL_ZEPHYR
#endif

#define NO_STDIO_FILESYSTEM
#define NO_WRITEV
#define NO_DEV_RANDOM
#define NO_MAIN_DRIVER
#define NO_BIO
#define WOLFCRYPT_ONLY
#define WOLFSSL_NO_STDIO
#define WOLFSSL_NO_STDIO_PRINTF
#define NO_PWDBASED
#define NO_ERROR_QUEUE
#define SINGLE_THREADED

#define WOLFSSL_SHA256
#define WOLFSSL_SHA512
#define WOLFSSL_SHA3
#define WOLFSSL_SHAKE128
#define WOLFSSL_SHAKE256
#define HAVE_HKDF
#undef NO_HMAC

#define HAVE_ED25519
#define HAVE_ED25519_VERIFY
#define HAVE_ED25519_KEY_IMPORT

#define WOLFSSL_HAVE_MLKEM
#define WOLFSSL_WC_MLKEM
#define WOLFSSL_WC_ML_KEM_512
#define WOLFSSL_NO_ML_KEM_768
#define WOLFSSL_NO_ML_KEM_1024
#define WOLFSSL_MLKEM_NO_MAKE_KEY
#define WOLFSSL_MLKEM_NO_ENCAPSULATE
#define WOLFSSL_MLKEM_SMALL

#define HAVE_DILITHIUM
#define WOLFSSL_WC_DILITHIUM
#define WOLFSSL_NO_ML_DSA_65
#define WOLFSSL_NO_ML_DSA_87
#define WOLFSSL_DILITHIUM_VERIFY_ONLY
#define WOLFSSL_DILITHIUM_VERIFY_SMALL_MEM
#define WOLFSSL_DILITHIUM_SMALL

#define WOLFSSL_SMALL_STACK
#define NO_ERROR_STRINGS

#define NO_RSA
#define NO_DH
#define NO_DSA
#define NO_RC4
#define NO_MD4
#define NO_MD5
#define NO_OLD_TLS
#define NO_CERTS
#define NO_AES

#define XMALLOC_OVERRIDE
#define XMALLOC(s, h, t) ((void)(h), (void)(t), k_malloc((size_t)(s)))
#define XFREE(p, h, t)                                                                             \
	do {                                                                                       \
		void *xp = (p);                                                                    \
		(void)(h), (void)(t);                                                              \
		if (xp) {                                                                          \
			k_free(xp);                                                                \
		}                                                                                  \
	} while (0)
#define XREALLOC(p, n, h, t) ((void)(h), (void)(t), k_realloc((p), (size_t)(n)))

#ifdef __cplusplus
}
#endif

#endif /* WOLFSSL_SETTINGS_H */
```

## include/teb_pq_client_keys.h
```c
#ifndef TEB_PQ_CLIENT_KEYS_H
#define TEB_PQ_CLIENT_KEYS_H

#include <stdint.h>

#include "teb_protocol.h"

/* Deterministic lab-only keys for reproducible ESP32 benchmarks. */
static const uint8_t teb_mlkem512_private_key[TEB_MLKEM512_PRIVATE_KEY_SIZE] = {
	0x6e, 0x85, 0x6e, 0x3f, 0xb0, 0x8c, 0x23, 0xf8, 0xad, 0x29, 0xd7, 0x6a,
	0x58, 0x9a, 0x4b, 0x80, 0xd3, 0x67, 0x8c, 0x3a, 0x0b, 0xd2, 0xda, 0x7b,
	0xb2, 0xc5, 0x99, 0x28, 0x87, 0x16, 0x83, 0xa6, 0xae, 0xfd, 0xa0, 0x50,
	0xd3, 0xa5, 0x98, 0x3e, 0xfa, 0xbe, 0xce, 0x65, 0x30, 0x54, 0xc2, 0x2c,
	0x4d, 0xf8, 0x55, 0xe0, 0xd1, 0x2e, 0x7c, 0x59, 0xc3, 0xd2, 0x92, 0xcb,
	0x5e, 0xba, 0x71, 0xf1, 0xe3, 0x7f, 0xcf, 0xf1, 0xc4, 0x8c, 0xd4, 0x6f,
	0xe0, 0xf2, 0xb1, 0x33, 0xca, 0x27, 0xe7, 0xeb, 0x03, 0x34, 0x92, 0x5a,
	0xc6, 0xd1, 0x3e, 0x11, 0x42, 0x88, 0xef, 0xd4, 0xae, 0x89, 0xab, 0x67,
	0xc3, 0xc3, 0x06, 0xea, 0x32, 0x89, 0x35, 0x07, 0x4e, 0x1c, 0xfb, 0xc7,
	0x4f, 0x23, 0x51, 0xe3, 0x99, 0x51, 0x85, 0xc5, 0x05, 0x9d, 0x53, 0x84,
	0xac, 0x73, 0xab, 0x74, 0xca, 0x33, 0xa0, 0xd2, 0x28, 0xe9, 0x48, 0x49,
	0x8d, 0xb8, 0x7c, 0xe4, 0x52, 0x54, 0xaa, 0x14, 0x99, 0x11, 0x81, 0x15,
	0xee, 0xb1, 0x02, 0xa9, 0x18, 0x75, 0xf2, 0x06, 0x75, 0x8c, 0x5a, 0xbf,
	0x3f, 0x5c, 0x94, 0x2a, 0xa2, 0x99, 0xe8, 0x98, 0x1e, 0x82, 0xfb, 0x0d,
	0x18, 0x96, 0x95, 0x44, 0x37, 0x31, 0x81, 0xd8, 0xbb, 0xc1, 0x05, 0x07,
	0x21, 0xd7, 0xb2, 0x94, 0xa3, 0x85, 0xed, 0xd7, 0x95, 0x74, 0x25, 0x30,
	0x55, 0x39, 0x05, 0xe1, 0x1c, 0x23, 0x72, 0x2a, 0x56, 0x7d, 0xc0, 0x7e,
	0xc9, 0xd6, 0x04, 0x4d, 0x2a, 0xb8, 0x6f, 0x4c, 0x55, 0x10, 0xc4, 0xbe,
	0x6a, 0x01, 0x03, 0x53, 0xe2, 0x49, 0x7c, 0xf0, 0xcc, 0xc5, 0x79, 0xce,
	0x76, 0x62, 0xa5, 0x1c, 0xbb, 0x84, 0xf4, 0x9c, 0x68, 0xc2, 0x03, 0x36,
	0x20, 0x79, 0x23, 0xfa, 0x33, 0x28, 0x81, 0xcc, 0xc3, 0x6f, 0xda, 0x79,
	0x02, 0xe8, 0x1b, 0xbc, 0x02, 0x2d, 0xf2, 0xa6, 0x9a, 0x04, 0x33, 0x0b,
	0xd2, 0x37, 0xb4, 0x84, 0x75, 0x55, 0x68, 0x0a, 0xc9, 0x27, 0xd0, 0x86,
	0x92, 0xab, 0x79, 0xa5, 0xd0, 0x89, 0x54, 0xc4, 0x66, 0x3b, 0x18, 0x6c,
	0x59, 0xd5, 0xa5, 0x8a, 0xe3, 0x64, 0x1c, 0xda, 0x7d, 0x57, 0x78, 0x90,
	0x08, 0x93, 0xb1, 0x5d, 0xb6, 0xc4, 0x24, 0xc1, 0x55, 0x65, 0xb0, 0x4a,
	0x48, 0x94, 0x50, 0x8d, 0xf1, 0x3d, 0x5a, 0xf4, 0x9b, 0xf0, 0xb5, 0x7a,
	0x0d, 0x0b, 0x49, 0xa1, 0x47, 0x17, 0xb4, 0x1c, 0x20, 0xcd, 0x3c, 0xbd,
	0x69, 0x00, 0x75, 0x6f, 0x2b, 0x69, 0x7a, 0x3a, 0x3c, 0xe6, 0xd2, 0x3e,
	0x1e, 0xcc, 0x9f, 0xde, 0xb9, 0x12, 0x4e, 0xab, 0x14, 0xc1, 0x51, 0x2a,
	0xb2, 0x88, 0x81, 0x1b, 0x56, 0x5a, 0xd5, 0x40, 0x80, 0x4a, 0x35, 0x26,
	0x94, 0x93, 0xa1, 0x74, 0x42, 0x05, 0x6e, 0xc7, 0xcf, 0xfe, 0x0b, 0x54,
	0x99, 0x42, 0x96, 0xcf, 0x52, 0xa5, 0xd1, 0x32, 0x47, 0x51, 0xfc, 0x76,
	0x70, 0x18, 0x3c, 0x28, 0x38, 0xad, 0x32, 0xb4, 0xbe, 0x77, 0xcc, 0x98,
	0x83, 0x7b, 0x66, 0x37, 0x3c, 0xa2, 0xfb, 0x39, 0x2b, 0x0c, 0xc7, 0x57,
	0x6b, 0x10, 0x94, 0x8e, 0x6b, 0x32, 0x75, 0x0b, 0x66, 0xeb, 0x08, 0x00,
	0x17, 0x80, 0x04, 0x61, 0x4c, 0x27, 0xd5, 0x54, 0x54, 0xf2, 0xa7, 0x63,
	0x59, 0x38, 0x26, 0x43, 0xc4, 0x06, 0x2b, 0xd3, 0x77, 0xac, 0xa7, 0xcc,
	0x9e, 0xd9, 0xaf, 0xab, 0x0b, 0x4d, 0x0a, 0xdb, 0x3a, 0x7e, 0x9a, 0x39,
	0xa8, 0xe3, 0xc5, 0xa6, 0xa8, 0x77, 0x84, 0x4c, 0x7e, 0x80, 0x31, 0x67,
	0xbb, 0xa8, 0x4d, 0x82, 0x33, 0x0b, 0xe0, 0x18, 0x13, 0x6c, 0x19, 0x2f,
	0x8a, 0x10, 0x4b, 0x8e, 0xe5, 0xb4, 0xf2, 0x17, 0x7a, 0x52, 0x89, 0xcd,
	0x2b, 0xc6, 0x0e, 0x55, 0xab, 0x89, 0x3d, 0xd5, 0x0d, 0xdd, 0x26, 0x42,
	0x5b, 0x07, 0x71, 0x07, 0x11, 0x21, 0x2e, 0x78, 0x2e, 0x05, 0x02, 0x2f,
	0xf4, 0xc8, 0x28, 0xfa, 0xe4, 0x3e, 0x43, 0xc1, 0x8e, 0x84, 0x2a, 0x0e,
	0xa1, 0x82, 0x75, 0x91, 0x0c, 0xb0, 0x87, 0xb1, 0xb4, 0x1c, 0x37, 0x9f,
	0x74, 0x64, 0xa7, 0xce, 0xc5, 0x1e, 0x7e, 0xc9, 0xaa, 0xf3, 0x51, 0x8d,
	0x60, 0xb2, 0x12, 0x3b, 0xd5, 0x7a, 0xa3, 0xe8, 0xb7, 0x59, 0xd8, 0x82,
	0x7d, 0xe3, 0x8f, 0x72, 0x93, 0x29, 0xd6, 0x9c, 0xa7, 0xec, 0x12, 0x45,
	0x28, 0xc2, 0x49, 0x98, 0x96, 0x16, 0xed, 0x43, 0xb8, 0x8d, 0xab, 0x13,
	0xc0, 0xec, 0x62, 0x7c, 0x62, 0x12, 0xc3, 0xd7, 0x8f, 0xa5, 0x82, 0x8c,
	0x54, 0xc0, 0x98, 0x00, 0x17, 0x18, 0xab, 0xd2, 0x73, 0xce, 0x97, 0xbe,
	0x59, 0x0a, 0x6c, 0xf9, 0x86, 0x89, 0x0c, 0x95, 0x70, 0x7c, 0xa9, 0x70,
	0x36, 0xa2, 0x5e, 0x8a, 0xa3, 0xb1, 0x35, 0xb9, 0x6a, 0x12, 0x23, 0x36,
	0x74, 0x25, 0x82, 0xad, 0x8b, 0x4c, 0xf6, 0x07, 0x9b, 0xf1, 0x41, 0x15,
	0x19, 0x66, 0xa5, 0x2c, 0x86, 0x3d, 0xdf, 0x26, 0x04, 0xe6, 0x33, 0x61,
	0x4f, 0xc6, 0x28, 0x1b, 0x13, 0xc6, 0xe2, 0xc3, 0x6f, 0xdc, 0xd7, 0x03,
	0x5a, 0x09, 0xbd, 0x9a, 0xc4, 0x77, 0xba, 0x26, 0x0e, 0x94, 0xf8, 0x92,
	0x5a, 0xc4, 0xa5, 0xd5, 0x22, 0xb2, 0xd6, 0x62, 0x2c, 0xb1, 0x65, 0x39,
	0x43, 0xdb, 0x68, 0xf1, 0x3b, 0x2d, 0xc6, 0x34, 0x7b, 0xf9, 0x26, 0x15,
	0xe4, 0xb3, 0x6d, 0x1b, 0xec, 0xc0, 0xdf, 0xaa, 0x9d, 0x43, 0xf6, 0x38,
	0xa6, 0xb5, 0x78, 0x89, 0x28, 0x6a, 0x61, 0x80, 0xcf, 0x18, 0x9a, 0xc1,
	0x17, 0x2a, 0x15, 0x80, 0x59, 0xa3, 0xb1, 0x69, 0x5c, 0x59, 0x81, 0xb9,
	0x02, 0xc0, 0xc9, 0x7d, 0x18, 0x27, 0x81, 0x1a, 0x0c, 0xd3, 0xc4, 0x7b,
	0x38, 0x96, 0xa0, 0x9c, 0x90, 0x45, 0xbe, 0x5a, 0x95, 0x3a, 0xb5, 0x49,
	0xdf, 0x18, 0xa2, 0x35, 0xb6, 0xbd, 0xf0, 0x75, 0x13, 0xd0, 0x57, 0x0f,
	0x59, 0xd0, 0x4b, 0xa8, 0x51, 0xa3, 0x11, 0x01, 0x02, 0x5a, 0xd6, 0x5d,
	0xd1, 0x76, 0x5b, 0xae, 0x0a, 0x4d, 0x34, 0x6c, 0x03, 0x4d, 0x96, 0x9d,
	0xee, 0xc9, 0x42, 0x55, 0x36, 0x0a, 0x7d, 0x63, 0xa9, 0xcf, 0xf9, 0x2a,
	0x90, 0x39, 0x7e, 0xa0, 0x77, 0x28, 0xda, 0xc4, 0x3b, 0x7e, 0xb2, 0x29,
	0xc0, 0x57, 0x3a, 0xb3, 0xfb, 0x11, 0x4a, 0x36, 0x1c, 0xf7, 0xb2, 0x71,
	0x12, 0x53, 0x50, 0x99, 0x0a, 0x71, 0x81, 0xaa, 0x81, 0xd2, 0x60, 0x32,
	0xfb, 0x9b, 0x62, 0x86, 0xec, 0x53, 0x3e, 0x13, 0xbd, 0x0b, 0x24, 0xbd,
	0xff, 0x90, 0xb3, 0x99, 0x83, 0x36, 0x36, 0x21, 0x27, 0xab, 0xb9, 0xbd,
	0x78, 0xd5, 0xa9, 0x7f, 0xf5, 0x45, 0xb9, 0x47, 0x86, 0x98, 0x5b, 0x2d,
	0xc1, 0x02, 0xb0, 0x55, 0x5a, 0x73, 0xc5, 0xab, 0x3e, 0x65, 0x49, 0x13,
	0x9c, 0x7c, 0x86, 0x6e, 0x25, 0xc6, 0xd4, 0x66, 0xbd, 0x6b, 0x80, 0x76,
	0x4f, 0x75, 0x54, 0x46, 0x9a, 0x81, 0x09, 0xb9, 0x9c, 0xb3, 0x7b, 0x8c,
	0x5c, 0xd8, 0x97, 0xd7, 0x45, 0x03, 0xf6, 0x65, 0xca, 0xde, 0xea, 0x63,
	0xad, 0x20, 0x6a, 0x41, 0xc2, 0xb7, 0x32, 0x61, 0x85, 0x6d, 0x00, 0x2d,
	0x37, 0x60, 0x9a, 0x5e, 0xe9, 0x2d, 0xb9, 0x82, 0x85, 0xef, 0xd9, 0x5f,
	0xd9, 0x70, 0x56, 0xc2, 0xe5, 0xb5, 0x7e, 0x6a, 0x4e, 0x78, 0x0a, 0xbe,
	0x93, 0xc4, 0x75, 0xe4, 0x13, 0x2a, 0xf3, 0xe9, 0x5c, 0x5e, 0x9b, 0x8c,
	0xa2, 0x90, 0x31, 0x34, 0xb7, 0x9b, 0x14, 0xe3, 0xcf, 0xc3, 0x12, 0x67,
	0xbe, 0x8a, 0x04, 0xdd, 0xa7, 0x2e, 0x91, 0x25, 0x47, 0xd5, 0x7b, 0x14,
	0x8d, 0x68, 0xa5, 0xf6, 0x35, 0x90, 0x79, 0x37, 0x3a, 0x83, 0xd8, 0x09,
	0x4e, 0xf6, 0x11, 0x04, 0xb4, 0xbe, 0x59, 0xe5, 0x2b, 0x93, 0x29, 0x85,
	0xa2, 0x32, 0xca, 0xa3, 0x38, 0x2d, 0x79, 0x50, 0x44, 0xe4, 0xf2, 0x84,
	0x4c, 0x16, 0xb6, 0x32, 0x83, 0x24, 0x5f, 0x61, 0xb9, 0x4d, 0x3b, 0x1d,
	0x3e, 0x20, 0x39, 0xae, 0xe4, 0x50, 0x4b, 0x36, 0xc3, 0x5b, 0x53, 0x3b,
	0x9a, 0x97, 0xab, 0xc3, 0xd9, 0x73, 0xc4, 0x95, 0x88, 0x36, 0x27, 0x4a,
	0x16, 0xc7, 0x6b, 0x0c, 0x6c, 0x8a, 0x62, 0xbb, 0x1a, 0x32, 0x89, 0xbb,
	0xf3, 0x86, 0x6e, 0xe7, 0xdb, 0x89, 0x9b, 0x33, 0x33, 0x0e, 0x40, 0x77,
	0x03, 0xc5, 0x0c, 0xdd, 0x65, 0x97, 0xe3, 0x73, 0x56, 0xfd, 0x61, 0x93,
	0xe3, 0x8b, 0x05, 0x6c, 0xf8, 0x6f, 0x44, 0x04, 0x56, 0x56, 0xc6, 0x90,
	0x3a, 0xdc, 0x5e, 0xa2, 0x10, 0xb8, 0x2f, 0xb9, 0x93, 0x78, 0x38, 0xb8,
	0xd0, 0xe5, 0x76, 0x07, 0x80, 0x05, 0xbe, 0xe5, 0xae, 0xc2, 0xfa, 0x8d,
	0x51, 0xa4, 0x29, 0x4d, 0xf5, 0xac, 0xfc, 0xb5, 0x36, 0xc9, 0x2a, 0x72,
	0x34, 0x11, 0x0f, 0x14, 0xe5, 0x78, 0x31, 0x73, 0x77, 0x25, 0xd1, 0x42,
	0x23, 0x89, 0xa4, 0x1d, 0x8b, 0x28, 0x43, 0x2c, 0x55, 0x9e, 0xac, 0xba,
	0xa9, 0x84, 0x68, 0xaa, 0x56, 0xa1, 0x39, 0x67, 0x22, 0xb2, 0x49, 0x25,
	0xcc, 0xc6, 0xa8, 0xe4, 0x93, 0x7b, 0x9e, 0x79, 0x63, 0x22, 0x91, 0xb3,
	0x80, 0xac, 0x15, 0x31, 0xb9, 0x45, 0xae, 0x55, 0x16, 0x26, 0xb0, 0x18,
	0x90, 0xd8, 0x28, 0x00, 0x11, 0x89, 0xcf, 0x9a, 0x6d, 0xbe, 0xd7, 0x1e,
	0x23, 0xa3, 0x6c, 0x68, 0x02, 0x80, 0x8d, 0x1a, 0x2a, 0xae, 0x91, 0xb9,
	0x30, 0x12, 0xce, 0x76, 0xbb, 0xc7, 0x66, 0xb1, 0x82, 0xc0, 0xd1, 0x4c,
	0xdc, 0x3c, 0xbd, 0x44, 0x23, 0xa1, 0x96, 0x75, 0xa1, 0xe1, 0x8c, 0xc6,
	0xc6, 0xc6, 0x85, 0x53, 0x36, 0x32, 0x46, 0xa2, 0xa5, 0x9e, 0x03, 0x0e,
	0xd7, 0x6b, 0x3f, 0x42, 0x91, 0x4a, 0xbb, 0x89, 0x93, 0x03, 0xf2, 0x5f,
	0xea, 0x22, 0x64, 0xdc, 0x74, 0x84, 0x50, 0x01, 0xba, 0xa0, 0x16, 0x1a,
	0xc0, 0x85, 0x00, 0xd3, 0x37, 0x1d, 0x32, 0x4a, 0x06, 0xa7, 0x42, 0x66,
	0x27, 0xbb, 0x5e, 0x8d, 0xab, 0x5a, 0x19, 0x4a, 0x5d, 0x6d, 0x91, 0xb8,
	0x7f, 0x3c, 0x9f, 0xa5, 0x3b, 0x2f, 0xa8, 0x49, 0x6e, 0x74, 0x49, 0xa8,
	0xad, 0xca, 0x27, 0xc3, 0xe0, 0xaa, 0x34, 0x26, 0x1e, 0xa1, 0x6b, 0xa5,
	0xda, 0x6c, 0x76, 0x22, 0x10, 0x87, 0xcc, 0x31, 0xca, 0x39, 0xa1, 0x69,
	0xdf, 0xc8, 0xc6, 0x4f, 0xd3, 0xbb, 0x8f, 0x66, 0x46, 0x6f, 0xac, 0x69,
	0x10, 0x76, 0x3f, 0xf3, 0xcb, 0xc3, 0xac, 0x67, 0x9b, 0xff, 0x03, 0x49,
	0x02, 0x67, 0x3d, 0xcf, 0xdc, 0x65, 0xfc, 0x69, 0x3f, 0x9a, 0x01, 0xd0,
	0x4a, 0x68, 0x50, 0x07, 0xfc, 0xbd, 0x0b, 0x01, 0x4f, 0x97, 0x73, 0x72,
	0x0a, 0xeb, 0x3a, 0xa3, 0x0b, 0x47, 0xb7, 0x64, 0x50, 0x8b, 0x4b, 0xa2,
	0x42, 0x67, 0xbb, 0x71, 0xc2, 0x36, 0xe8, 0x5a, 0x80, 0x82, 0x16, 0x53,
	0xa2, 0xd4, 0x84, 0x32, 0xa7, 0xb2, 0xf7, 0xec, 0xb7, 0x1b, 0xfa, 0xb0,
	0xa6, 0x14, 0x60, 0x60, 0x37, 0x6c, 0xb3, 0x5b, 0x54, 0x09, 0x42, 0x6f,
	0x62, 0x5c, 0xa5, 0x6c, 0x24, 0x86, 0x84, 0x9b, 0x4b, 0x77, 0x95, 0x02,
	0x2f, 0x95, 0xac, 0x81, 0x93, 0x66, 0x69, 0x08, 0x1d, 0x82, 0x94, 0x1d,
	0xb8, 0x13, 0xac, 0x17, 0x08, 0xc0, 0x0c, 0x57, 0x36, 0x1c, 0xb1, 0x94,
	0x91, 0xc9, 0x6e, 0xf2, 0xe0, 0xa5, 0x70, 0x76, 0x80, 0xca, 0xfa, 0x83,
	0x14, 0x93, 0x44, 0xd1, 0xb7, 0x45, 0x69, 0x46, 0x92, 0x9d, 0x0c, 0x4e,
	0x6a, 0x66, 0xab, 0x10, 0x45, 0x99, 0xa6, 0xc2, 0xeb, 0xa7, 0x7f, 0xcc,
	0xda, 0xbd, 0x31, 0x96, 0x70, 0xf3, 0xfc, 0xac, 0x0f, 0xb0, 0xf9, 0xdf,
	0xf0, 0xe3, 0xb3, 0xdd, 0x45, 0x3e, 0x10, 0xff, 0xb1, 0x4b, 0x4c, 0x10,
	0x03, 0x4c, 0x09, 0xfa, 0x65, 0x42, 0x4a, 0xaa, 0x94, 0xc2, 0xfb, 0x5f,
	0xe4, 0x70, 0xad, 0x43, 0x35, 0x7d, 0x8a, 0x27, 0x59, 0x95, 0x47, 0x4c,
	0x57, 0x6f, 0x87, 0x4d, 0x62, 0xd3, 0x93, 0x15, 0x4c, 0x37, 0xe7, 0xcf,
	0x73, 0xc5, 0xa8, 0x12, 0xaa, 0x27, 0x34, 0xe2, 0x15, 0x8f, 0x06, 0xf8,
	0xa1, 0x40, 0x28, 0x95, 0x70, 0x3b, 0x50, 0x79, 0xec, 0x54, 0xac, 0x79
};

static const uint8_t teb_mldsa44_public_key[TEB_MLDSA44_PUBLIC_KEY_SIZE] = {
	0xcf, 0x45, 0x34, 0xb6, 0x5a, 0x10, 0xc7, 0x73, 0x2f, 0x8c, 0x95, 0xba,
	0xd4, 0x62, 0xb5, 0x82, 0x5a, 0xe8, 0x52, 0x71, 0x0e, 0x6d, 0x24, 0x91,
	0x7e, 0x36, 0xfa, 0xea, 0x4f, 0x97, 0x20, 0x24, 0xf2, 0x96, 0xa1, 0xde,
	0x1c, 0xaa, 0x98, 0x6b, 0x65, 0x16, 0xf8, 0xf4, 0x9f, 0x46, 0x1b, 0xe5,
	0xfa, 0xf9, 0x5d, 0xe1, 0xb4, 0xf4, 0x94, 0x09, 0x33, 0xc8, 0x59, 0x58,
	0x49, 0xd8, 0xd5, 0x14, 0xd4, 0xd2, 0xdf, 0x1c, 0xab, 0x64, 0x74, 0x2b,
	0x98, 0x38, 0x07, 0x99, 0xd8, 0x91, 0xc6, 0xb7, 0xdd, 0x51, 0x7a, 0xad,
	0x34, 0xb3, 0xbb, 0x13, 0xd3, 0xb8, 0x48, 0xf4, 0xbc, 0x55, 0xf9, 0xa4,
	0x13, 0x18, 0x4b, 0x34, 0xf6, 0x95, 0xce, 0xbc, 0x84, 0xc2, 0x24, 0xc6,
	0xba, 0x5a, 0x43, 0xef, 0xb7, 0xb9, 0x1f, 0xe0, 0xfd, 0xe5, 0xbd, 0xd1,
	0x8b, 0xab, 0x1d, 0x1a, 0x88, 0x5a, 0x26, 0xce, 0x3f, 0x97, 0x69, 0xa1,
	0x29, 0x44, 0x8c, 0x55, 0x94, 0x97, 0x2e, 0xaf, 0x04, 0x7d, 0x98, 0x96,
	0x46, 0x98, 0x44, 0x55, 0x2d, 0x93, 0x10, 0x1b, 0x1a, 0xb8, 0x6b, 0x5d,
	0xc6, 0x0a, 0x02, 0x55, 0x59, 0x3d, 0x97, 0xea, 0x98, 0x49, 0x77, 0x92,
	0x6c, 0x04, 0x9e, 0x03, 0x70, 0xd0, 0x39, 0x8b, 0x2d, 0x2e, 0x2c, 0x2c,
	0xdf, 0x24, 0x83, 0x8c, 0xd9, 0x0c, 0x4c, 0x8e, 0x83, 0xb3, 0xf9, 0xcb,
	0xb5, 0xdd, 0xf6, 0x52, 0xe5, 0x91, 0x8d, 0x2c, 0x5c, 0xcd, 0xb2, 0x4a,
	0xe8, 0xb1, 0xed, 0x8a, 0x61, 0xb7, 0xec, 0x54, 0x1b, 0x74, 0x81, 0xc7,
	0xc2, 0xeb, 0x91, 0xf4, 0xc9, 0x86, 0x8f, 0xaf, 0x04, 0x6d, 0xad, 0x78,
	0xc3, 0x4e, 0x6f, 0x98, 0x95, 0x86, 0x73, 0x2b, 0x8e, 0xf0, 0xb1, 0x5e,
	0x3a, 0x45, 0x2d, 0x63, 0x68, 0xe3, 0x9e, 0x12, 0x8d, 0xae, 0x80, 0x0a,
	0x2c, 0x83, 0xec, 0x3b, 0xa1, 0x41, 0x30, 0xf2, 0x2a, 0xcc, 0x04, 0x09,
	0xc9, 0x07, 0x94, 0x65, 0xf8, 0xd8, 0x1a, 0x25, 0xc8, 0x8d, 0x9a, 0x48,
	0x2e, 0x36, 0x61, 0xaf, 0x82, 0x82, 0xa6, 0x51, 0x28, 0x9a, 0xa3, 0x29,
	0xb1, 0xab, 0xcf, 0x13, 0xa7, 0x39, 0xfb, 0xe4, 0x94, 0x52, 0x4e, 0x09,
	0x96, 0x3e, 0xcd, 0x92, 0x3a, 0x93, 0xb5, 0x2a, 0xc4, 0x37, 0x59, 0x17,
	0x99, 0x97, 0xc8, 0x26, 0x4f, 0x9d, 0x30, 0x53, 0xe4, 0x8f, 0xe1, 0xcd,
	0x77, 0xd8, 0xee, 0x97, 0x53, 0xc6, 0x75, 0xa9, 0x12, 0x9c, 0x07, 0x92,
	0x13, 0xd1, 0x54, 0x78, 0x03, 0x83, 0x59, 0xb9, 0xb2, 0x82, 0x6c, 0x80,
	0x91, 0x55, 0x5f, 0xe6, 0x9e, 0x12, 0xd1, 0x6c, 0x3e, 0x33, 0xfc, 0x5d,
	0xea, 0x22, 0xb0, 0xb8, 0x8e, 0xdd, 0x04, 0xa3, 0x6d, 0xf1, 0xbc, 0x34,
	0xef, 0xb4, 0x0a, 0xe6, 0xc1, 0x0e, 0x65, 0x8a, 0xd0, 0x8d, 0x78, 0x64,
	0x8d, 0x2b, 0xd6, 0xdf, 0x95, 0x1b, 0x14, 0x0a, 0xe2, 0xd1, 0xbe, 0xa5,
	0x72, 0xc7, 0x8c, 0xd1, 0xd6, 0x1a, 0xbb, 0x6a, 0xf2, 0x2c, 0xd5, 0xf6,
	0x46, 0x41, 0x63, 0x04, 0x82, 0x1f, 0x6c, 0x11, 0x03, 0xf7, 0xba, 0x6e,
	0x15, 0x58, 0x76, 0x45, 0x3b, 0x3c, 0x95, 0x92, 0x45, 0xf5, 0x80, 0x1c,
	0xb6, 0xa1, 0x5e, 0xfd, 0x5f, 0x37, 0x16, 0x76, 0x12, 0xcc, 0x8b, 0x48,
	0xda, 0x84, 0x89, 0x73, 0x5c, 0xaa, 0x9d, 0x1b, 0x2c, 0x9f, 0x2c, 0x2d,
	0x96, 0x56, 0xc7, 0x07, 0xe8, 0xf9, 0xc2, 0x8b, 0x25, 0x9b, 0x71, 0x37,
	0x99, 0xea, 0xcd, 0xc5, 0x71, 0x18, 0xf4, 0x42, 0x47, 0x8f, 0x8a, 0x9b,
	0x70, 0xca, 0xab, 0x65, 0x9f, 0x14, 0x91, 0x33, 0x7d, 0x7a, 0x93, 0x82,
	0x88, 0xa6, 0x45, 0x92, 0x58, 0xd9, 0x6f, 0x0d, 0xea, 0x34, 0x03, 0x71,
	0x2c, 0xa4, 0x7a, 0x40, 0x1c, 0x17, 0xf9, 0x5c, 0xdd, 0x98, 0xe1, 0x73,
	0x2f, 0xc6, 0x2a, 0xf0, 0x87, 0x52, 0x6a, 0xd2, 0x76, 0x02, 0x69, 0xc3,
	0xec, 0xec, 0xbb, 0x36, 0xfb, 0xce, 0x77, 0x0d, 0xc2, 0x1d, 0x31, 0xdc,
	0x13, 0x8e, 0xf5, 0x62, 0xba, 0x64, 0x5d, 0xb6, 0x26, 0x3e, 0xb4, 0xef,
	0xd1, 0x03, 0xfa, 0xeb, 0xd3, 0xa8, 0xc0, 0xa3, 0xc9, 0x29, 0xa9, 0x32,
	0x69, 0xe6, 0x79, 0x00, 0x4a, 0x9d, 0x53, 0x39, 0xba, 0x15, 0x6e, 0x14,
	0x78, 0x17, 0xcd, 0x7b, 0xa4, 0xf2, 0x4f, 0x3a, 0x28, 0xfe, 0x4d, 0xa8,
	0xa2, 0xe4, 0xbd, 0x58, 0x4e, 0xac, 0x4a, 0xba, 0xf3, 0x03, 0x40, 0x04,
	0x74, 0x84, 0x16, 0x13, 0x3d, 0x5c, 0xe7, 0x1c, 0xdf, 0x05, 0x88, 0x2d,
	0xc7, 0xbb, 0x39, 0xe2, 0x71, 0xcb, 0xb5, 0x2a, 0x82, 0xad, 0x57, 0xae,
	0x7d, 0x9c, 0xdb, 0xe3, 0xa0, 0x73, 0xaf, 0xab, 0x8f, 0xee, 0xda, 0x24,
	0xd5, 0x47, 0xd3, 0x3c, 0x5f, 0x85, 0xc5, 0x81, 0xa2, 0x61, 0x3d, 0x3d,
	0xad, 0xaf, 0xdf, 0xd4, 0x4e, 0xa3, 0x15, 0x26, 0xab, 0x72, 0x9a, 0xb6,
	0xb8, 0xee, 0x9b, 0x5c, 0x61, 0xa0, 0xd2, 0x52, 0x88, 0x24, 0x99, 0xd8,
	0x76, 0x61, 0xce, 0xfa, 0x95, 0x88, 0xd2, 0x2e, 0x22, 0x5d, 0x52, 0x73,
	0xd5, 0x1a, 0xfa, 0x4e, 0x55, 0x49, 0x1d, 0x05, 0x84, 0x3b, 0x1b, 0xa1,
	0xf7, 0x26, 0x5f, 0xe2, 0x35, 0x63, 0x03, 0xfe, 0x71, 0x28, 0x79, 0xec,
	0x89, 0x4b, 0xb9, 0x28, 0x9d, 0x0a, 0x47, 0x0e, 0x04, 0x4b, 0xd4, 0x0e,
	0x7e, 0x36, 0x8f, 0xd3, 0x85, 0xb6, 0xec, 0x88, 0x05, 0x75, 0x3c, 0x91,
	0xad, 0x95, 0xd7, 0x88, 0xb2, 0xcd, 0xc6, 0xa5, 0x7b, 0xc3, 0xbc, 0x6e,
	0x43, 0x28, 0x61, 0xe3, 0x57, 0x1d, 0xee, 0x4b, 0xf9, 0xf4, 0xdd, 0xc8,
	0x68, 0xeb, 0x4b, 0xd7, 0xce, 0x46, 0x61, 0x57, 0xf7, 0x1a, 0xff, 0x0e,
	0x6c, 0xef, 0xa8, 0x9c, 0x61, 0x12, 0x81, 0x6b, 0x8f, 0xf4, 0x24, 0x0f,
	0xcb, 0xfa, 0x3b, 0x99, 0xe9, 0xfc, 0x26, 0xf6, 0xe8, 0x3a, 0x60, 0x01,
	0xa8, 0x27, 0x71, 0x32, 0x78, 0x1a, 0x00, 0xee, 0x7b, 0x10, 0xe8, 0xa5,
	0x03, 0x1d, 0xf7, 0x71, 0x28, 0x72, 0xa2, 0xcf, 0xb5, 0xa6, 0x16, 0x15,
	0xb9, 0xbf, 0x4b, 0xce, 0x62, 0x28, 0x04, 0x5e, 0x14, 0x96, 0x8e, 0xb7,
	0xaa, 0xc3, 0x4b, 0x1e, 0x87, 0x58, 0xa1, 0xda, 0x7a, 0x66, 0x6e, 0x79,
	0xdc, 0xf1, 0x92, 0xfc, 0x1e, 0x78, 0x6c, 0x89, 0x0a, 0x3e, 0xc0, 0x14,
	0xdb, 0x14, 0xa5, 0xb8, 0xa8, 0xde, 0xa0, 0x9e, 0x76, 0xde, 0xe7, 0xa6,
	0xca, 0x5e, 0x6c, 0xd2, 0x6f, 0x68, 0xf1, 0x0e, 0x8a, 0xf8, 0x35, 0xf3,
	0x8b, 0x19, 0x8b, 0x3f, 0x29, 0x88, 0xca, 0x00, 0x08, 0xb6, 0xb5, 0xcd,
	0xf3, 0xba, 0x94, 0x5b, 0x34, 0x2e, 0xc8, 0xe2, 0x6b, 0x77, 0xa0, 0xfb,
	0x81, 0x4a, 0x77, 0x3d, 0xcf, 0x14, 0xb8, 0x4d, 0xd7, 0x52, 0xf6, 0x0d,
	0x62, 0x2e, 0xe0, 0x79, 0x27, 0xea, 0xc4, 0xd8, 0xf7, 0x8a, 0xbd, 0x1a,
	0x56, 0x73, 0xe6, 0xa8, 0x50, 0x41, 0x85, 0x92, 0x5c, 0x1f, 0x1c, 0xcd,
	0x62, 0x73, 0xa6, 0x37, 0x03, 0x8a, 0xb0, 0xb1, 0xc1, 0xd2, 0x40, 0x7b,
	0x31, 0xe2, 0xb7, 0x68, 0xcf, 0xe0, 0x16, 0xda, 0x91, 0xf6, 0x2b, 0xa5,
	0x49, 0xa5, 0x8a, 0xdb, 0x57, 0xce, 0x2a, 0x0e, 0x84, 0x2c, 0xed, 0x3a,
	0xaf, 0x78, 0x89, 0xf6, 0x62, 0x7a, 0x63, 0x7b, 0xbc, 0xad, 0x90, 0x48,
	0x7b, 0x9f, 0xad, 0xc2, 0xf0, 0x6d, 0x91, 0xcc, 0xfb, 0x06, 0x24, 0xc2,
	0xb6, 0xa5, 0x33, 0x3d, 0x7d, 0x7f, 0x99, 0xaf, 0x76, 0xb6, 0x0a, 0xb0,
	0x94, 0xd6, 0x64, 0x2b, 0x9a, 0xa8, 0x6d, 0x96, 0x51, 0xcf, 0x36, 0xf6,
	0xfd, 0xb4, 0x74, 0xbe, 0x29, 0x4a, 0x8f, 0xde, 0x01, 0xd1, 0x8b, 0x2b,
	0xeb, 0xb8, 0x4f, 0xc7, 0xf6, 0xb8, 0x45, 0x0e, 0xd3, 0x73, 0x98, 0x82,
	0x43, 0xa6, 0x9f, 0xd5, 0x63, 0x89, 0x3c, 0x0c, 0x54, 0xe0, 0xf0, 0x8a,
	0xc8, 0x95, 0x2c, 0x59, 0xc9, 0xc4, 0x37, 0x63, 0x0f, 0x95, 0xef, 0xea,
	0xb0, 0xba, 0xa5, 0xb6, 0xe0, 0xaa, 0x7f, 0xa9, 0x61, 0x6f, 0x8a, 0x78,
	0x5e, 0x52, 0x3d, 0x64, 0xd1, 0x28, 0x0e, 0xb1, 0xc1, 0xe8, 0x0d, 0x24,
	0x3d, 0x8e, 0x01, 0x50, 0xbe, 0x73, 0x7f, 0x34, 0xcc, 0x24, 0xeb, 0x0d,
	0x02, 0x7f, 0x0e, 0xc6, 0xce, 0x65, 0x6d, 0xd9, 0x0f, 0x67, 0xf2, 0xf7,
	0xaa, 0x91, 0xcb, 0x7e, 0xeb, 0xc0, 0x1e, 0xa4, 0x12, 0xce, 0x3c, 0xc5,
	0x2b, 0x93, 0x70, 0xf6, 0x15, 0xc6, 0x2e, 0x2f, 0x6a, 0xf0, 0x06, 0x07,
	0x39, 0xea, 0x0f, 0xab, 0xf6, 0x45, 0x46, 0x84, 0x4d, 0x57, 0x20, 0xdc,
	0xd7, 0x23, 0xfc, 0xcb, 0x40, 0x8c, 0x43, 0xa8, 0x31, 0x3f, 0x14, 0xd4,
	0x5e, 0xf1, 0x2a, 0x8d, 0x4e, 0xd1, 0x59, 0xb8, 0xc0, 0x9e, 0x48, 0xd4,
	0x61, 0x27, 0x5d, 0x89, 0xb9, 0x85, 0x5c, 0x7c, 0xdd, 0x47, 0xf8, 0x99,
	0xb9, 0xa8, 0xf8, 0x3b, 0x47, 0x21, 0x1b, 0x27, 0x0a, 0xcd, 0x5a, 0xd6,
	0xc8, 0x80, 0x02, 0xe5, 0xf3, 0x2c, 0x0c, 0xf5, 0xc6, 0x19, 0x42, 0xd2,
	0x5e, 0x05, 0x49, 0xe5, 0x69, 0xa2, 0xe9, 0xa1, 0x13, 0x61, 0xa4, 0x9e,
	0x49, 0x0b, 0x98, 0x43, 0xac, 0x00, 0x74, 0xf9, 0xc8, 0x3e, 0xf6, 0xda,
	0xdc, 0xbd, 0xed, 0xf9, 0x8c, 0xa6, 0x38, 0x5c, 0xd8, 0x3b, 0xd8, 0xae,
	0x0d, 0x55, 0xcd, 0xa0, 0xa8, 0x11, 0x9c, 0xd8, 0x1b, 0xfa, 0x0c, 0x25,
	0xb0, 0xdd, 0x0c, 0x11, 0xbb, 0x82, 0x7d, 0x4b, 0x08, 0xb8, 0x9a, 0x92,
	0x70, 0xb0, 0xb0, 0x99, 0xdf, 0x62, 0x3b, 0x77, 0x6a, 0xd4, 0xbc, 0x53,
	0x66, 0xfb, 0x7c, 0xf8, 0x26, 0x77, 0x3f, 0x1a, 0xc3, 0x45, 0x40, 0x4d,
	0xcd, 0xab, 0xda, 0xef, 0xea, 0x5a, 0xfd, 0xfb, 0x8b, 0x3b, 0x1d, 0x35,
	0xd3, 0xa0, 0x9f, 0xc0
};

#endif /* TEB_PQ_CLIENT_KEYS_H */
```

## src/teb_crypto.c
```c
#include "teb_crypto.h"

#include <errno.h>
#include <stdbool.h>
#include <stdio.h>

#include <zephyr/kernel.h>

#include <wolfssl/wolfcrypt/dilithium.h>
#include <wolfssl/wolfcrypt/ed25519.h>
#include <wolfssl/wolfcrypt/hash.h>
#include <wolfssl/wolfcrypt/hmac.h>
#include <wolfssl/wolfcrypt/mlkem.h>
#include <wolfssl/wolfcrypt/wc_mlkem.h>

int teb_sha256(const uint8_t *in, size_t in_len, uint8_t out[TEB_HASH_SIZE])
{
	if (in_len > UINT32_MAX) {
		return -EMSGSIZE;
	}

	return wc_Sha256Hash(in, (word32)in_len, out);
}

int teb_hkdf_sha256(const uint8_t *ikm, size_t ikm_len, const uint8_t *salt, size_t salt_len,
		    const uint8_t *info, size_t info_len, uint8_t *out, size_t out_len)
{
	if (ikm_len > UINT32_MAX || salt_len > UINT32_MAX || info_len > UINT32_MAX ||
	    out_len > UINT32_MAX) {
		return -EMSGSIZE;
	}

	return wc_HKDF(WC_SHA256, ikm, (word32)ikm_len, salt, (word32)salt_len, info,
		       (word32)info_len, out, (word32)out_len);
}

int teb_verify_ed25519(const uint8_t pub[TEB_ED25519_PUB_SIZE], const uint8_t *msg, size_t msg_len,
		       const uint8_t sig[TEB_ED25519_SIG_SIZE])
{
	ed25519_key *key;
	int verify = 0;
	int ret;

	if (msg_len > UINT32_MAX) {
		return -EMSGSIZE;
	}

	key = k_malloc(sizeof(*key));
	if (key == NULL) {
		return -ENOMEM;
	}

	ret = wc_ed25519_init(key);
	if (ret != 0) {
		k_free(key);
		return ret;
	}

	ret = wc_ed25519_import_public(pub, TEB_ED25519_PUB_SIZE, key);
	if (ret == 0) {
		ret = wc_ed25519_verify_msg(sig, TEB_ED25519_SIG_SIZE, msg, (word32)msg_len,
					    &verify, key);
	}

	wc_ed25519_free(key);
	k_free(key);

	if (ret != 0) {
		return ret;
	}

	return verify == 1 ? 0 : -EACCES;
}

int teb_verify_mldsa44(const uint8_t pub[TEB_MLDSA44_PUBLIC_KEY_SIZE], const uint8_t *msg,
		       size_t msg_len, const uint8_t sig[TEB_MLDSA44_SIG_SIZE])
{
	dilithium_key *key;
	int verify = 0;
	int ret;
	bool inited = false;

	if (msg_len > UINT32_MAX) {
		return -EMSGSIZE;
	}

	key = k_malloc(sizeof(*key));
	if (key == NULL) {
		return -ENOMEM;
	}

	ret = wc_dilithium_init(key);
	if (ret == 0) {
		inited = true;
	}
	if (ret == 0) {
		ret = wc_dilithium_set_level(key, WC_ML_DSA_44);
	}
	if (ret == 0) {
		ret = wc_dilithium_import_public(pub, TEB_MLDSA44_PUBLIC_KEY_SIZE, key);
	}
	if (ret == 0) {
		ret = wc_dilithium_verify_ctx_msg(sig, TEB_MLDSA44_SIG_SIZE, NULL, 0, msg,
						  (word32)msg_len, &verify, key);
	}

	if (inited) {
		wc_dilithium_free(key);
	}
	k_free(key);

	if (ret != 0) {
		return ret;
	}

	return verify == 1 ? 0 : -EACCES;
}

int teb_mlkem512_decapsulate(const uint8_t priv[TEB_MLKEM512_PRIVATE_KEY_SIZE],
			     const uint8_t ct[TEB_MLKEM512_CIPHERTEXT_SIZE],
			     uint8_t ss[TEB_MLKEM512_SHARED_SECRET_SIZE])
{
	MlKemKey *key;
	int ret;
	bool inited = false;

	key = k_malloc(sizeof(*key));
	if (key == NULL) {
		return -ENOMEM;
	}

	ret = wc_MlKemKey_Init(key, WC_ML_KEM_512, NULL, INVALID_DEVID);
	if (ret == 0) {
		inited = true;
	}
	if (ret == 0) {
		ret = wc_MlKemKey_DecodePrivateKey(key, priv, TEB_MLKEM512_PRIVATE_KEY_SIZE);
	}
	if (ret == 0) {
		ret = wc_MlKemKey_Decapsulate(key, ss, ct, TEB_MLKEM512_CIPHERTEXT_SIZE);
	}

	if (inited) {
		wc_MlKemKey_Free(key);
	}
	k_free(key);

	return ret;
}

void teb_print_hex(const char *tag, const uint8_t *buf, size_t len)
{
	printf("%s", tag);
	for (size_t i = 0; i < len; i++) {
		printf("%02x", buf[i]);
	}
	printf("\n");
}
```

## src/teb_crypto.h
```c
#ifndef TEB_CRYPTO_H
#define TEB_CRYPTO_H

#include <stddef.h>
#include <stdint.h>

#include "teb_protocol.h"

int teb_sha256(const uint8_t *in, size_t in_len, uint8_t out[TEB_HASH_SIZE]);
int teb_hkdf_sha256(const uint8_t *ikm, size_t ikm_len, const uint8_t *salt, size_t salt_len,
		    const uint8_t *info, size_t info_len, uint8_t *out, size_t out_len);
int teb_verify_ed25519(const uint8_t pub[TEB_ED25519_PUB_SIZE], const uint8_t *msg, size_t msg_len,
		       const uint8_t sig[TEB_ED25519_SIG_SIZE]);
int teb_verify_mldsa44(const uint8_t pub[TEB_MLDSA44_PUBLIC_KEY_SIZE], const uint8_t *msg,
		       size_t msg_len, const uint8_t sig[TEB_MLDSA44_SIG_SIZE]);
int teb_mlkem512_decapsulate(const uint8_t priv[TEB_MLKEM512_PRIVATE_KEY_SIZE],
			     const uint8_t ct[TEB_MLKEM512_CIPHERTEXT_SIZE],
			     uint8_t ss[TEB_MLKEM512_SHARED_SECRET_SIZE]);
void teb_print_hex(const char *tag, const uint8_t *buf, size_t len);

#endif /* TEB_CRYPTO_H */
```

## src/teb_protocol.c
```c
#include "teb_protocol.h"

#include <errno.h>
#include <string.h>

void teb_store_u16_be(uint8_t *out, uint16_t v)
{
	out[0] = (uint8_t)(v >> 8);
	out[1] = (uint8_t)v;
}

void teb_store_u32_be(uint8_t *out, uint32_t v)
{
	out[0] = (uint8_t)(v >> 24);
	out[1] = (uint8_t)(v >> 16);
	out[2] = (uint8_t)(v >> 8);
	out[3] = (uint8_t)v;
}

void teb_store_u64_be(uint8_t *out, uint64_t v)
{
	for (int i = 7; i >= 0; i--) {
		out[7 - i] = (uint8_t)(v >> (i * 8));
	}
}

uint16_t teb_load_u16_be(const uint8_t *in)
{
	return ((uint16_t)in[0] << 8) | in[1];
}

uint32_t teb_load_u32_be(const uint8_t *in)
{
	return ((uint32_t)in[0] << 24) | ((uint32_t)in[1] << 16) | ((uint32_t)in[2] << 8) | in[3];
}

uint64_t teb_load_u64_be(const uint8_t *in)
{
	uint64_t v = 0;

	for (int i = 0; i < 8; i++) {
		v = (v << 8) | in[i];
	}

	return v;
}

void teb_build_hello(uint8_t out[TEB_HELLO_LEN], const struct teb_hello_fields *fields)
{
	memset(out, 0, TEB_HELLO_LEN);
	memcpy(out + 0, TEB_HELLO_MAGIC, 4);
	out[4] = TEB_VERSION;
	out[5] = TEB_SELECTED_PROFILE;
	teb_store_u16_be(out + 6, 0);
	teb_store_u64_be(out + 8, fields->device_id);
	teb_store_u32_be(out + 16, fields->boot_counter);
	teb_store_u32_be(out + 20, fields->uptime_ms);
	memcpy(out + 24, fields->sram_commitment, TEB_HASH_SIZE);
	memcpy(out + 56, fields->timing_commitment, TEB_HASH_SIZE);
}

int teb_parse_capsule(const uint8_t *buf, size_t len, struct teb_capsule_fields *fields)
{
	if (buf == NULL || fields == NULL) {
		return -EINVAL;
	}

	if (len != TEB_CAPSULE_LEN) {
		return -EMSGSIZE;
	}

	if (memcmp(buf + 0, TEB_CAPSULE_MAGIC, 4) != 0) {
		return -EBADMSG;
	}

	if (buf[4] != TEB_VERSION) {
		return -EPROTONOSUPPORT;
	}

	fields->profile = buf[5];
	if (fields->profile != TEB_SELECTED_PROFILE) {
		return -EPROTONOSUPPORT;
	}

	if (teb_load_u16_be(buf + 6) != TEB_CAPSULE_SIGNED_LEN) {
		return -EBADMSG;
	}

	fields->device_id = teb_load_u64_be(buf + 8);
	fields->boot_counter = teb_load_u32_be(buf + 16);
	fields->gateway_time_ms = teb_load_u64_be(buf + 20);
	fields->sequence = teb_load_u32_be(buf + 28);
#if TEB_SELECTED_PROFILE == TEB_PROFILE_DEV_ED25519_PUF_BEACON
	memcpy(fields->beacon, buf + 32, TEB_BEACON_SIZE);
	memcpy(fields->hello_hash, buf + 64, TEB_HASH_SIZE);
	fields->kem_ciphertext = NULL;
#else
	memset(fields->beacon, 0, sizeof(fields->beacon));
	fields->kem_ciphertext = buf + TEB_CAPSULE_HEADER_LEN;
	memcpy(fields->hello_hash, buf + TEB_CAPSULE_HEADER_LEN + TEB_MLKEM512_CIPHERTEXT_SIZE,
	       TEB_HASH_SIZE);
#endif
	fields->signature = buf + TEB_CAPSULE_SIGNED_LEN;

	return 0;
}
```

## src/teb_puf.h
```c
#ifndef TEB_PUF_H
#define TEB_PUF_H

#include <stddef.h>
#include <stdint.h>

#include "teb_protocol.h"

struct teb_puf_sample {
	uint8_t sram_secret[TEB_HASH_SIZE];
	uint8_t sram_commitment[TEB_HASH_SIZE];
	uint8_t timing_secret[TEB_HASH_SIZE];
	uint8_t timing_commitment[TEB_HASH_SIZE];
	uint32_t sram_ones;
	uint32_t sram_transitions;
	uint32_t timing_min_delta;
	uint32_t timing_max_delta;
	uint64_t timing_sum_delta;
};

void teb_puf_capture(struct teb_puf_sample *out);

#endif /* TEB_PUF_H */
```

## src/wifi.h
```c
#ifndef WIFI_H
#define WIFI_H

#include <stdbool.h>

#include <zephyr/kernel.h>
#include <zephyr/net/net_if.h>
#include <zephyr/net/wifi_mgmt.h>

extern struct wifi_connect_req_params wifi_params;

int wifi_init(struct device *unused);
int wait_for_wifi_connection(void);
int start_dhcp(void);
int wait_for_ipv4_address(void);
int connect_to_wifi(void);
void wifi_disconnect(void);
bool wifi_is_connected(void);
void wifi_set_event_logging(bool enabled);

#endif /* WIFI_H */
```
