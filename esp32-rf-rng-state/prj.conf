## CMakeLists.txt
```
#
# esp32-rf-rng-state/CMakeLists.txt
#
# Copyright (C) 2026 Javier Blanco-Romero @fj-blanco (UC3M, QURSA project)
#
# RF-TRNG Benchmark: measures ESP32 TRNG behaviour under different
# RF subsystem operating modes.
#

cmake_minimum_required(VERSION 3.20.0)

find_package(Zephyr REQUIRED HINTS $ENV{ZEPHYR_BASE})
project(esp32_rf_rng_state)

# -- Benchmark condition ------------------------------------------
# BENCH_CONDITION selects the RF operating mode at compile time.
# Valid values: RF_DISABLED, WIFI_IDLE, WIFI_SCAN, UDP_BURST, WIFI_TRAFFIC
set(BENCH_CONDITION_VALUE $ENV{BENCH_CONDITION})
if(DEFINED BENCH_CONDITION)
    set(BENCH_CONDITION_VALUE ${BENCH_CONDITION})
endif()

if(NOT BENCH_CONDITION_VALUE)
    set(BENCH_CONDITION_VALUE "RF_DISABLED")
endif()

set(VALID_BENCH_CONDITIONS RF_DISABLED WIFI_IDLE WIFI_SCAN UDP_BURST WIFI_TRAFFIC)
list(FIND VALID_BENCH_CONDITIONS "${BENCH_CONDITION_VALUE}" BENCH_CONDITION_INDEX)
if(BENCH_CONDITION_INDEX EQUAL -1)
    message(FATAL_ERROR
        "Invalid BENCH_CONDITION=${BENCH_CONDITION_VALUE}. "
        "Valid values: RF_DISABLED, WIFI_IDLE, WIFI_SCAN, UDP_BURST")
endif()

# -- Wi-Fi credentials (conditions 2-4) --------------------------
set(WIFI_SSID_VALUE $ENV{WIFI_SSID})
set(WIFI_PASS_VALUE $ENV{WIFI_PASS})
if(DEFINED WIFI_SSID)
    set(WIFI_SSID_VALUE ${WIFI_SSID})
endif()
if(DEFINED WIFI_PASS)
    set(WIFI_PASS_VALUE ${WIFI_PASS})
endif()
if(NOT WIFI_SSID_VALUE)
    set(WIFI_SSID_VALUE "WIFI_SSID_NOT_SET")
endif()
if(NOT WIFI_PASS_VALUE)
    set(WIFI_PASS_VALUE "WIFI_PASS_NOT_SET")
endif()

# -- UDP burst receiver (condition 4) ----------------------------
set(UDP_BURST_PORT_VALUE $ENV{UDP_BURST_PORT})
if(DEFINED UDP_BURST_PORT)
    set(UDP_BURST_PORT_VALUE ${UDP_BURST_PORT})
endif()
if(DEFINED UDP_TARGET_PORT)
    set(UDP_BURST_PORT_VALUE ${UDP_TARGET_PORT})
endif()
if(NOT UDP_BURST_PORT_VALUE)
    set(UDP_BURST_PORT_VALUE "9999")
endif()

set(UDP_BURST_PAYLOAD_SIZE_VALUE $ENV{UDP_BURST_PAYLOAD_SIZE})
if(DEFINED UDP_BURST_PAYLOAD_SIZE)
    set(UDP_BURST_PAYLOAD_SIZE_VALUE ${UDP_BURST_PAYLOAD_SIZE})
endif()
if(NOT UDP_BURST_PAYLOAD_SIZE_VALUE)
    set(UDP_BURST_PAYLOAD_SIZE_VALUE "64")
endif()

set(UDP_BURST_EXPECT_BYTE_VALUE $ENV{UDP_BURST_EXPECT_BYTE})
if(DEFINED UDP_BURST_EXPECT_BYTE)
    set(UDP_BURST_EXPECT_BYTE_VALUE ${UDP_BURST_EXPECT_BYTE})
endif()
if(NOT UDP_BURST_EXPECT_BYTE_VALUE)
    set(UDP_BURST_EXPECT_BYTE_VALUE "0x42")
endif()

# -- Raw dump size -----------------------------------------------
set(TRNG_RAW_DUMP_BYTES_VALUE $ENV{TRNG_RAW_DUMP_BYTES})
if(DEFINED TRNG_RAW_DUMP_BYTES)
    set(TRNG_RAW_DUMP_BYTES_VALUE ${TRNG_RAW_DUMP_BYTES})
endif()
if(NOT TRNG_RAW_DUMP_BYTES_VALUE)
    set(TRNG_RAW_DUMP_BYTES_VALUE "268435456")
endif()

set(TRNG_RAW_START_DELAY_MS_VALUE $ENV{TRNG_RAW_START_DELAY_MS})
if(DEFINED TRNG_RAW_START_DELAY_MS)
    set(TRNG_RAW_START_DELAY_MS_VALUE ${TRNG_RAW_START_DELAY_MS})
endif()
if(NOT TRNG_RAW_START_DELAY_MS_VALUE)
    set(TRNG_RAW_START_DELAY_MS_VALUE "15000")
endif()

# -- Include paths ------------------------------------------------
zephyr_include_directories(include)
target_include_directories(app PRIVATE ${CMAKE_CURRENT_SOURCE_DIR}/include)

# -- Sources ------------------------------------------------------
target_sources(app PRIVATE
    src/main.c
    src/trng_bench.c
)

# Conditionally add Wi-Fi and UDP sources
if(NOT BENCH_CONDITION_VALUE STREQUAL "RF_DISABLED")
    target_sources(app PRIVATE src/wifi.c)
endif()

if(BENCH_CONDITION_VALUE STREQUAL "WIFI_TRAFFIC" OR BENCH_CONDITION_VALUE STREQUAL "UDP_BURST")
    target_sources(app PRIVATE src/udp_flood.c)
endif()

# -- Compile definitions -----------------------------------------
target_compile_definitions(app PRIVATE
    BENCH_CONDITION_${BENCH_CONDITION_VALUE}=1
    WIFI_SSID="${WIFI_SSID_VALUE}"
    WIFI_PASS="${WIFI_PASS_VALUE}"
    UDP_BURST_PORT=${UDP_BURST_PORT_VALUE}
    UDP_BURST_PAYLOAD_SIZE=${UDP_BURST_PAYLOAD_SIZE_VALUE}
    UDP_BURST_EXPECT_BYTE=${UDP_BURST_EXPECT_BYTE_VALUE}
    TRNG_RAW_DUMP_BYTES=${TRNG_RAW_DUMP_BYTES_VALUE}ULL
    TRNG_RAW_START_DELAY_MS=${TRNG_RAW_START_DELAY_MS_VALUE}
)

message(STATUS "...............................................")
message(STATUS "RF-TRNG Benchmark")
message(STATUS "  Condition:    ${BENCH_CONDITION_VALUE}")
message(STATUS "  Raw bytes:    ${TRNG_RAW_DUMP_BYTES_VALUE}")
message(STATUS "  Raw delay ms: ${TRNG_RAW_START_DELAY_MS_VALUE}")
if(NOT BENCH_CONDITION_VALUE STREQUAL "RF_DISABLED")
    message(STATUS "  WiFi SSID:    ${WIFI_SSID_VALUE}")
endif()
if(BENCH_CONDITION_VALUE STREQUAL "WIFI_TRAFFIC" OR BENCH_CONDITION_VALUE STREQUAL "UDP_BURST")
    message(STATUS "  UDP burst:    port ${UDP_BURST_PORT_VALUE}, ${UDP_BURST_PAYLOAD_SIZE_VALUE} bytes, byte ${UDP_BURST_EXPECT_BYTE_VALUE}")
endif()
message(STATUS "...............................................") 
```

## west.yml
```
manifest:
  defaults:
    remote: zephyrproject

  remotes:
    - name: zephyrproject
      url-base: https://github.com/zephyrproject-rtos

  projects:
    # Stock Zephyr v4.1.0 - NO custom fork.
    # We want the unmodified entropy_esp32.c driver so measurements
    # reflect the raw WDEV_RND_REG path without BLAKE2s pool conditioning.
    - name: zephyr
      remote: zephyrproject
      repo-path: zephyr
      revision: v4.1.0
      path: zephyr
      import: true

  self:
    path: .
```

## prj.conf
```kconfig
# RF-TRNG Benchmark - Base Configuration
# This is the RF-DISABLED (pseudo-random) baseline.
# Wi-Fi overlay (overlay/wifi.conf) adds networking for conditions 2-4.

# Core System
CONFIG_NEWLIB_LIBC=y
CONFIG_POSIX_API=y

# Memory - lightweight benchmark, no TLS stack
CONFIG_MAIN_STACK_SIZE=8192
CONFIG_SYSTEM_WORKQUEUE_STACK_SIZE=2048
CONFIG_HEAP_MEM_POOL_SIZE=32768

# Debugging / Output
CONFIG_LOG=y
CONFIG_LOG_DEFAULT_LEVEL=2
CONFIG_PRINTK=y
CONFIG_EARLY_CONSOLE=y

# Hardware
CONFIG_SERIAL=y
CONFIG_UART_CONSOLE=y
CONFIG_CONSOLE=y
CONFIG_GPIO=y

# Entropy - stock ESP32 TRNG driver (no BLAKE2s pool)
CONFIG_ENTROPY_GENERATOR=y

# Heap statistics for memory monitoring
CONFIG_SYS_HEAP_RUNTIME_STATS=y

# Disable unused subsystems to save DRAM
CONFIG_SHELL=n
CONFIG_PM=n
CONFIG_SMP=n
```

## boards/esp32_devkitc_procpu.conf
```kconfig
# ESP32 Board Configuration
```

## boards/esp32_devkitc_wroom_procpu.conf
```kconfig
# ESP32 Board Configuration

CONFIG_ESP32_USE_UNSUPPORTED_REVISION=y
```

## app.overlay
```dts
/*
 * esp32-rf-rng-state/app.overlay
 *
 * Devicetree overlay to configure the console UART at high speed (921600 bps)
 * for rapid raw binary data collection.
 */

/ {
	chosen {
		zephyr,console = &uart0;
		zephyr,shell-uart = &uart0;
	};
};

&uart0 {
	status = "okay";
	current-speed = <921600>;
};

&wifi {
	status = "okay";
};
```

## src/main.c
```c
/*
 * esp32-rf-rng-state/src/main.c
 *
 * Copyright (C) 2026 Javier Blanco-Romero @fj-blanco (UC3M, QURSA project)
 *
 * RF-TRNG Benchmark: measures ESP32 hardware TRNG behaviour under
 * different RF subsystem operating modes.
 *
 * Experimental conditions (selected at compile time via BENCH_CONDITION_*):
 *
 *   1. RF_DISABLED   - No Wi-Fi driver.  The ESP32 TRNG falls back to
 *                      pseudo-random output because the RF/ADC noise
 *                      source is inactive.  This is a documented
 *                      baseline, not a valid entropy condition.
 *
 *   2. WIFI_IDLE     - Wi-Fi associated and DHCP obtained, but no
 *                      application-layer traffic.  The RF subsystem is
 *                      enabled; the WDEV register receives hardware
 *                      noise.  Best clean true-entropy baseline.
 *
 *   3. WIFI_SCAN     - Wi-Fi associated with periodic active scans.
 *                      This generates RF activity (probe requests,
 *                      channel hopping) without application data,
 *                      separating "RF activity" from "app workload."
 *
 *   4. UDP_BURST     - Wi-Fi associated while a gateway sends a
 *                      deterministic public UDP burst train to the DUT.
 *                      This mirrors the RF-actuated AEB traffic direction
 *                      while measuring only WDEV bytes.
 *
 * The benchmark does NOT use the custom BLAKE2s entropy pool fork.
 * It reads directly from the stock Zephyr entropy_esp32 driver
 * (WDEV_RND_REG) so the pool conditioning cannot mask or alter
 * the raw hardware RNG behaviour.
 *
 * References:
 *   - entropy_esp32.c:46-52  (WDEV_RND_REG + APB timing)
 *   - Kconfig.esp32:14-16    (pseudo-entropy warning)
 *   - espressif,esp32-trng.yaml:7-8 (Wi-Fi/BT noise coupling)
 */

#include <stdio.h>
#include <stdlib.h>
#include <string.h>
#include <zephyr/kernel.h>
#include <zephyr/device.h>
#include <zephyr/drivers/entropy.h>

#include "trng_bench.h"

/* Conditionally include Wi-Fi and UDP headers */
#if !defined(BENCH_CONDITION_RF_DISABLED)
#include "wifi.h"
#endif

#if defined(BENCH_CONDITION_WIFI_TRAFFIC) || defined(BENCH_CONDITION_UDP_BURST)
#include "udp_flood.h"
#endif

/* -- Condition label ------------------------------------------- */

static const char *get_condition_label(void)
{
#if defined(BENCH_CONDITION_RF_DISABLED)
	return "rf_disabled";
#elif defined(BENCH_CONDITION_WIFI_IDLE)
	return "wifi_idle";
#elif defined(BENCH_CONDITION_WIFI_SCAN)
	return "wifi_scan";
#elif defined(BENCH_CONDITION_UDP_BURST)
	return "udp_burst";
#elif defined(BENCH_CONDITION_WIFI_TRAFFIC)
	return "udp_burst";
#else
	return "unknown";
#endif
}

/* -- Wi-Fi setup (conditions 2-4) ------------------------------ */

#if !defined(BENCH_CONDITION_RF_DISABLED)
static int setup_wifi(void)
{
	wifi_init(NULL);

	int ret = connect_to_wifi();
	if (ret < 0) {
		printk("[MAIN] Wi-Fi connection failed: %d\n", ret);
		return ret;
	}

	/* Allow DHCP and ARP to settle */
	printk("[MAIN] Wi-Fi connected, waiting for network stack...\n");
	k_sleep(K_MSEC(3000));

	return 0;
}
#endif

/* -- Scan loop for wifi_scan condition -------------------------- */

#if defined(BENCH_CONDITION_WIFI_SCAN)

#define SCAN_INTERVAL_MS 5000 /* Trigger a scan every 5 seconds */

static volatile bool scan_thread_running = false;

#define SCAN_THREAD_STACK_SIZE 2048
#define SCAN_THREAD_PRIORITY   12

static K_THREAD_STACK_DEFINE(scan_thread_stack, SCAN_THREAD_STACK_SIZE);
static struct k_thread scan_thread_data;

static void scan_thread_fn(void *p1, void *p2, void *p3)
{
	ARG_UNUSED(p1);
	ARG_UNUSED(p2);
	ARG_UNUSED(p3);

	int scan_count = 0;

	while (scan_thread_running) {
		wifi_trigger_scan();
		scan_count++;
		if (wifi_event_logging_enabled()) {
			printk("[SCAN] Scan #%d triggered\n", scan_count);
		}
		k_sleep(K_MSEC(SCAN_INTERVAL_MS));
	}

	if (wifi_event_logging_enabled()) {
		printk("[SCAN] Thread stopped after %d scans\n", scan_count);
	}
}

static void start_scan_thread(void)
{
	scan_thread_running = true;
	k_thread_create(&scan_thread_data, scan_thread_stack, SCAN_THREAD_STACK_SIZE,
			scan_thread_fn, NULL, NULL, NULL, SCAN_THREAD_PRIORITY, 0, K_NO_WAIT);
	k_thread_name_set(&scan_thread_data, "wifi_scan");
}

static void stop_scan_thread(void)
{
	scan_thread_running = false;
	k_thread_join(&scan_thread_data, K_SECONDS(10));
}

#endif /* BENCH_CONDITION_WIFI_SCAN */

/* -- Main ------------------------------------------------------ */

int main(void)
{
	const struct device *entropy_dev;
	const char *condition = get_condition_label();

	printk("\n========================================\n");
	printk("RF-TRNG Benchmark\n");
	printk("Condition: %s\n", condition);
	printk("========================================\n");

	/* Get the entropy device.
	 *
	 * On stock Zephyr without BLAKE2s overlay, zephyr,entropy points
	 * directly to trng0 (espressif,esp32-trng).  This gives us raw
	 * WDEV_RND_REG reads through entropy_esp32.c.
	 */
	entropy_dev = DEVICE_DT_GET(DT_CHOSEN(zephyr_entropy));
	if (!device_is_ready(entropy_dev)) {
		printk("FATAL: Entropy device not ready\n");
		return EXIT_FAILURE;
	}

	printk("Entropy device: %s\n", entropy_dev->name);

	/* Wait for serial monitor to attach after flash+reset */
	printk("Waiting for serial monitor...\n");
	k_msleep(5000);

	/* -- Condition-specific setup -------------------------------- */

#if defined(BENCH_CONDITION_RF_DISABLED)
	printk("\n[MAIN] Condition: RF_DISABLED\n");
	printk("[MAIN] WARNING: Without Wi-Fi/BT enabled, the ESP32 TRNG\n");
	printk("[MAIN] produces pseudo-random output (WDEV register not fed\n");
	printk("[MAIN] by RF noise).  This is a documented pseudo-random\n");
	printk("[MAIN] baseline, NOT a valid entropy source.\n\n");

#elif defined(BENCH_CONDITION_WIFI_IDLE)
	printk("\n[MAIN] Condition: WIFI_IDLE\n");
	if (setup_wifi() != 0) {
		printk("FATAL: Wi-Fi setup failed\n");
		return EXIT_FAILURE;
	}
	printk("[MAIN] Wi-Fi idle - RF subsystem enabled, no app traffic\n\n");

#elif defined(BENCH_CONDITION_WIFI_SCAN)
	printk("\n[MAIN] Condition: WIFI_SCAN\n");
	if (setup_wifi() != 0) {
		printk("FATAL: Wi-Fi setup failed\n");
		return EXIT_FAILURE;
	}
	printk("[MAIN] Starting periodic Wi-Fi scans...\n");
	start_scan_thread();
	/* Let the first scan complete before benchmarking */
	k_sleep(K_MSEC(SCAN_INTERVAL_MS + 2000));
	printk("[MAIN] Scan thread running - measuring TRNG concurrently\n\n");

#elif defined(BENCH_CONDITION_WIFI_TRAFFIC) || defined(BENCH_CONDITION_UDP_BURST)
	printk("\n[MAIN] Condition: UDP_BURST\n");
	if (setup_wifi() != 0) {
		printk("FATAL: Wi-Fi setup failed\n");
		return EXIT_FAILURE;
	}
	printk("[MAIN] Starting deterministic UDP burst receiver...\n");
	if (udp_flood_start() != 0) {
		printk("FATAL: UDP burst receiver start failed\n");
		return EXIT_FAILURE;
	}
	/* Give the host a moment to see the IPv4 line and start sending bursts. */
	k_sleep(K_MSEC(3000));
	printk("[MAIN] UDP burst receiver running - measuring TRNG concurrently\n\n");

#else
	printk("FATAL: No valid BENCH_CONDITION_* defined\n");
	return EXIT_FAILURE;
#endif

	/* -- Run TRNG benchmarks ------------------------------------ */

	trng_bench_run_all(entropy_dev, condition);

	/* -- Condition-specific teardown ---------------------------- */

#if defined(BENCH_CONDITION_WIFI_SCAN)
	stop_scan_thread();
#endif

#if defined(BENCH_CONDITION_WIFI_TRAFFIC) || defined(BENCH_CONDITION_UDP_BURST)
	udp_flood_stop();
	udp_flood_report_stats();
#endif

#if !defined(BENCH_CONDITION_RF_DISABLED)
	wifi_disconnect();
#endif

	printk("\n========================================\n");
	printk("RF-TRNG Benchmark Complete (%s)\n", condition);
	printk("========================================\n");

	return EXIT_SUCCESS;
}
```

## include/config-mbedtls-wifi.h
```c
/*
 * config-mbedtls-wifi.h
 * Minimal mbedTLS configuration for ESP32 WiFi driver (WPA2-Personal) ONLY.
 *
 * The application TLS/DTLS backend uses wolfSSL, NOT mbedTLS.
 * This config provides only the raw crypto primitives that the ESP-IDF
 * wpa_supplicant needs: AES, CCM, CMAC, SHA-256, HMAC, DES, bignum, NIST-KW.
 *
 * Copyright (C) 2006-2015, ARM Limited, All Rights Reserved
 * Copyright (c) 2017 Intel Corporation.
 * Copyright (c) 2018 Nordic Semiconductor ASA
 * Copyright (C) 2024-2025 Javier Blanco-Romero @fj-blanco (UC3M, QURSA project)
 *
 * SPDX-License-Identifier: Apache-2.0
 */

#ifndef CONFIG_MBEDTLS_WIFI_H
#define CONFIG_MBEDTLS_WIFI_H

/* ---- Crypto primitives used by wpa_supplicant ---- */

/* AES (ECB/CBC/CTR) - always needed for WPA2 CCMP */
#ifndef MBEDTLS_AES_C
#define MBEDTLS_AES_C
#endif

/* CCM mode - used by WPA2 CCMP */
#if defined(MBEDTLS_CCM_C)
#ifndef MBEDTLS_CCM_GCM_CAN_AES
#define MBEDTLS_CCM_GCM_CAN_AES
#endif
#endif

/* SHA-256 - needed for HMAC / key derivation in 4-way handshake */
#ifndef MBEDTLS_MD_CAN_SHA256
#define MBEDTLS_MD_CAN_SHA256
#endif

#endif /* CONFIG_MBEDTLS_WIFI_H */
```

## src/trng_bench.c
```c
/*
 * esp32-rf-rng-state/src/trng_bench.c
 *
 * Copyright (C) 2026 Javier Blanco-Romero @fj-blanco (UC3M, QURSA project)
 *
 * TRNG measurement routines for the RF-TRNG benchmark.
 *
 * Measures the ESP32 hardware TRNG (WDEV_RND_REG) throughput, per-call
 * latency, and collects raw output for offline statistical analysis.
 *
 * IMPORTANT: This benchmark reads from the stock Zephyr entropy_esp32
 * driver, NOT the BLAKE2s entropy pool.  The goal is to observe the raw
 * hardware RNG behaviour under different RF subsystem states.
 */

#include <stdio.h>
#include <string.h>
#include <zephyr/kernel.h>
#include <zephyr/device.h>
#include <zephyr/drivers/entropy.h>
#include <zephyr/drivers/uart.h>

#include "trng_bench.h"

#if !defined(BENCH_CONDITION_RF_DISABLED)
#include "wifi.h"
#endif

/* -- High-resolution timing ------------------------------------ */
/*
 * ESP32 @ 240 MHz -> ~4.17 ns per cycle.
 * k_cycle_get_32() wraps every ~17.9s; unsigned subtraction handles it.
 */
static inline uint32_t get_cycles(void)
{
	return k_cycle_get_32();
}

static inline uint32_t cycles_to_us(uint32_t start, uint32_t end)
{
	return k_cyc_to_us_floor32(end - start);
}

static void uart_write_str(const struct device *uart_dev, const char *text)
{
	while (*text != '\0') {
		uart_poll_out(uart_dev, *text++);
	}
}

/* -- Latency measurement --------------------------------------- */

void trng_bench_latency(const struct device *entropy_dev)
{
	uint8_t buf[TRNG_BENCH_BLOCK_SIZE];
	char meta_buf[32];

	printk("\n--- TRNG Per-Call Latency (%d iterations, %d bytes/call) ---\n",
	       TRNG_BENCH_ITERATIONS, TRNG_BENCH_BLOCK_SIZE);

	/* Warmup: prime any internal state / caches */
	for (int w = 0; w < TRNG_BENCH_WARMUP; w++) {
		entropy_get_entropy(entropy_dev, buf, TRNG_BENCH_BLOCK_SIZE);
	}

	/* Measured iterations */
	for (int i = 0; i < TRNG_BENCH_ITERATIONS; i++) {
		memset(buf, 0, TRNG_BENCH_BLOCK_SIZE);

		uint32_t c0 = get_cycles();
		int ret = entropy_get_entropy(entropy_dev, buf, TRNG_BENCH_BLOCK_SIZE);
		uint32_t c1 = get_cycles();

		if (ret == 0) {
			BENCH_RESULT("trng_latency", TRNG_BENCH_BLOCK_SIZE, i,
				     cycles_to_us(c0, c1));
		} else {
			printk("[BENCH_ERR] trng_latency,%d,%d,ret=%d\n", TRNG_BENCH_BLOCK_SIZE, i,
			       ret);
		}
	}

	snprintf(meta_buf, sizeof(meta_buf), "%d", TRNG_BENCH_ITERATIONS);
	BENCH_META("latency_iterations", meta_buf);
}

/* -- Throughput measurement ------------------------------------ */

void trng_bench_throughput(const struct device *entropy_dev)
{
	uint8_t buf[TRNG_BENCH_BLOCK_SIZE];

	printk("\n--- TRNG Throughput (%d windows x %d ms, %d bytes/read) ---\n",
	       TRNG_THROUGHPUT_WINDOWS, TRNG_THROUGHPUT_WINDOW_MS, TRNG_BENCH_BLOCK_SIZE);

	/* Warmup */
	for (int w = 0; w < TRNG_BENCH_WARMUP; w++) {
		entropy_get_entropy(entropy_dev, buf, TRNG_BENCH_BLOCK_SIZE);
	}

	for (int win = 0; win < TRNG_THROUGHPUT_WINDOWS; win++) {
		uint64_t bytes_read = 0;
		uint32_t c_start = get_cycles();
		int64_t deadline = k_uptime_get() + TRNG_THROUGHPUT_WINDOW_MS;

		while (k_uptime_get() < deadline) {
			int ret = entropy_get_entropy(entropy_dev, buf, TRNG_BENCH_BLOCK_SIZE);
			if (ret == 0) {
				bytes_read += TRNG_BENCH_BLOCK_SIZE;
			}
		}

		uint32_t c_end = get_cycles();
		uint32_t elapsed_us = cycles_to_us(c_start, c_end);

		/* bytes_per_sec = bytes_read * 1000000 / elapsed_us */
		uint64_t bytes_per_sec = 0;
		if (elapsed_us > 0) {
			bytes_per_sec = (bytes_read * 1000000ULL) / elapsed_us;
		}

		BENCH_RESULT("trng_throughput", TRNG_BENCH_BLOCK_SIZE, win,
			     (uint64_t)bytes_per_sec);

		printk("  [window %d] %llu bytes in %u us -> %llu B/s\n", win,
		       (unsigned long long)bytes_read, elapsed_us,
		       (unsigned long long)bytes_per_sec);
	}
}

/* -- Raw byte dump --------------------------------------------- */

void trng_bench_raw_dump(const struct device *entropy_dev)
{
	/*
	 * Collect TRNG_RAW_DUMP_BYTES in chunks and emit as raw binary.
	 * We use a moderately sized chunk (256 bytes) to keep memory footprint
	 * low on the ESP32 while avoiding tiny transfers.
	 */
	const size_t chunk_size = 256;
	uint8_t chunk[256];
	uint64_t total = TRNG_RAW_DUMP_BYTES;
	char meta_buf[32];
	const struct device *uart_dev = DEVICE_DT_GET(DT_CHOSEN(zephyr_console));

	printk("\n--- TRNG Raw Byte Dump (%llu bytes) ---\n", (unsigned long long)total);
	snprintf(meta_buf, sizeof(meta_buf), "%llu", (unsigned long long)total);
	BENCH_META("raw_dump_bytes", meta_buf);
	snprintf(meta_buf, sizeof(meta_buf), "%d", TRNG_RAW_START_DELAY_MS);
	BENCH_META("raw_start_delay_ms", meta_buf);

	printk("[BENCH_RAW_ARMED] delay_ms,%d,trigger,G\n", TRNG_RAW_START_DELAY_MS);
	k_msleep(TRNG_RAW_START_DELAY_MS);

	while (true) {
		unsigned char trigger;

		if (uart_poll_in(uart_dev, &trigger) == 0 && trigger == 'G') {
			break;
		}

		k_msleep(10);
	}

	uart_write_str(uart_dev, "[BENCH_RAW_START]\n");
	k_msleep(100); /* Wait for the start marker to clear the console TX ring buffer */

	while (total > 0) {
		size_t to_read = (total < chunk_size) ? (size_t)total : chunk_size;
		int ret = entropy_get_entropy(entropy_dev, chunk, to_read);

		if (ret != 0) {
			printk("\n[BENCH_ERR] raw_dump,ret=%d\n", ret);
			break;
		}

		/* Stream the binary chunk byte-by-byte directly to the UART FIFO */
		for (size_t i = 0; i < to_read; i++) {
			uart_poll_out(uart_dev, chunk[i]);
		}

		total -= to_read;
		k_yield();
	}

	k_msleep(100); /* Wait for binary transmission to finish before the end marker */
	uart_write_str(uart_dev, "\n[BENCH_RAW_END]\n");
}

/* -- Run all benchmarks ---------------------------------------- */

void trng_bench_run_all(const struct device *entropy_dev, const char *condition)
{
	char meta_buf[32];

	printk("\n========================================\n");
	printk("RF-TRNG Benchmark - Condition: %s\n", condition);
	printk("========================================\n");

	BENCH_HEADER();

	/* Metadata */
	BENCH_META("board", CONFIG_BOARD_TARGET);
	BENCH_META("condition", condition);
	BENCH_META("entropy_driver", entropy_dev->name);
	snprintf(meta_buf, sizeof(meta_buf), "%d", TRNG_BENCH_BLOCK_SIZE);
	BENCH_META("sample_size", meta_buf);
	snprintf(meta_buf, sizeof(meta_buf), "%d", TRNG_BENCH_ITERATIONS);
	BENCH_META("iterations", meta_buf);
	snprintf(meta_buf, sizeof(meta_buf), "%d", TRNG_THROUGHPUT_WINDOWS);
	BENCH_META("throughput_windows", meta_buf);
	snprintf(meta_buf, sizeof(meta_buf), "%d", TRNG_THROUGHPUT_WINDOW_MS);
	BENCH_META("throughput_window_ms", meta_buf);
	snprintf(meta_buf, sizeof(meta_buf), "%d", CONFIG_HEAP_MEM_POOL_SIZE);
	BENCH_META("heap_pool_size", meta_buf);

	/* Phase 1: Latency */
	printk("\n======== Phase 1: Per-Call Latency ========\n");
	trng_bench_latency(entropy_dev);

	/* Phase 2: Throughput */
	printk("\n======== Phase 2: Sustained Throughput ========\n");
	trng_bench_throughput(entropy_dev);

	/* Phase 3: Raw dump */
	printk("\n======== Phase 3: Raw Byte Collection ========\n");

#if !defined(BENCH_CONDITION_RF_DISABLED)
	if (wifi_reconnect() != 0) {
		printk("[BENCH_ERR] wifi_reconnect_before_raw\n");
	}
	BENCH_META("wifi_connected_before_raw", wifi_is_connected() ? "true" : "false");
	wifi_set_event_logging(false);
#endif

	trng_bench_raw_dump(entropy_dev);

#if !defined(BENCH_CONDITION_RF_DISABLED)
	wifi_set_event_logging(true);
#endif

	BENCH_FOOTER();

	printk("\n========================================\n");
	printk("RF-TRNG Benchmark Complete (%s)\n", condition);
	printk("========================================\n");
}
```

## src/trng_bench.h
```c
/*
 * esp32-rf-rng-state/src/trng_bench.h
 *
 * Copyright (C) 2026 Javier Blanco-Romero @fj-blanco (UC3M, QURSA project)
 *
 * TRNG measurement routines for the RF-TRNG benchmark.
 */

#ifndef TRNG_BENCH_H
#define TRNG_BENCH_H

#include <zephyr/device.h>
#include <stdint.h>
#include <stdbool.h>

/* -- Benchmark parameters --------------------------------------- */

/* Number of entropy_get_entropy() calls per latency measurement round */
#define TRNG_BENCH_ITERATIONS 500

/* Number of warmup calls before measurement (primes caches/state) */
#define TRNG_BENCH_WARMUP 10

/* Block size for each entropy read (bytes) */
#define TRNG_BENCH_BLOCK_SIZE 32

/* Total bytes of raw RNG output to collect for offline analysis.
 * 256 MiB is enough for the strongest practical randlab screening suites
 * in a per-condition run: PractRand, TestU01, GM/T, AIS31, SP 800-90B,
 * Borel, and ENT. NIST STS and Dieharder remain long optional runs.
 */
#ifndef TRNG_RAW_DUMP_BYTES
#define TRNG_RAW_DUMP_BYTES 268435456ULL
#endif

/* Delay before the raw marker so the host can open the serial port after reset. */
#ifndef TRNG_RAW_START_DELAY_MS
#define TRNG_RAW_START_DELAY_MS 15000
#endif

/* Number of throughput measurement windows */
#define TRNG_THROUGHPUT_WINDOWS 10

/* Duration of each throughput window in milliseconds */
#define TRNG_THROUGHPUT_WINDOW_MS 1000

/* -- Structured output macros ----------------------------------- */
/* Compatible with the QEaaS benchmark parser */

#define BENCH_HEADER() printk("\n[BENCH_START]\n")
#define BENCH_FOOTER() printk("[BENCH_END]\n\n")
#define BENCH_RESULT(test, param, iter, us)                                                        \
	printk("[BENCH] %s,%d,%d,%llu\n", (test), (param), (iter), (unsigned long long)(us))
#define BENCH_META(key, val) printk("[BENCH_META] %s,%s\n", (key), (val))

/* -- API -------------------------------------------------------- */

/**
 * Run per-call latency measurements.
 *
 * Calls entropy_get_entropy(dev, buf, TRNG_BENCH_BLOCK_SIZE) repeatedly
 * and records the cycle-accurate latency of each call.
 *
 * Emits: [BENCH] trng_latency,<block_size>,<iter>,<us>
 */
void trng_bench_latency(const struct device *entropy_dev);

/**
 * Run throughput measurements.
 *
 * Reads entropy in a tight loop for TRNG_THROUGHPUT_WINDOW_MS ms per
 * window and reports bytes/sec.
 *
 * Emits: [BENCH] trng_throughput,<block_size>,<window>,<bytes_per_sec>
 */
void trng_bench_throughput(const struct device *entropy_dev);

/**
 * Collect raw RNG output and dump as binary.
 *
 * Reads TRNG_RAW_DUMP_BYTES from the entropy driver and emits them
 * as raw bytes between [BENCH_RAW_START] / [BENCH_RAW_END] tags
 * for offline statistical analysis.
 */
void trng_bench_raw_dump(const struct device *entropy_dev);

/**
 * Run all benchmarks in sequence: latency, throughput, raw dump.
 */
void trng_bench_run_all(const struct device *entropy_dev, const char *condition);

#endif /* TRNG_BENCH_H */
```

## src/udp_flood.c
```c
/*
 * Deterministic UDP-burst receiver for the wifi_traffic/udp_burst condition.
 */

#include <errno.h>
#include <stdio.h>
#include <string.h>
#include <zephyr/kernel.h>
#include <zephyr/net/socket.h>

#include "trng_bench.h"
#include "udp_flood.h"

#define UDP_BURST_STACK_SIZE 4096
#define UDP_BURST_PRIORITY   0

static K_THREAD_STACK_DEFINE(udp_burst_stack, UDP_BURST_STACK_SIZE);
static struct k_thread udp_burst_thread;
static volatile bool udp_burst_running;

static volatile uint32_t udp_rx_packets;
static volatile uint32_t udp_rx_bad_size;
static volatile uint32_t udp_rx_bad_payload;
static volatile uint32_t udp_rx_errors;
static volatile uint64_t udp_rx_bytes;
static volatile uint32_t udp_first_rx_ms;
static volatile uint32_t udp_last_rx_ms;

static bool payload_is_expected(const uint8_t *buf, size_t len)
{
	for (size_t i = 0; i < len; i++) {
		if (buf[i] != (uint8_t)UDP_BURST_EXPECT_BYTE) {
			return false;
		}
	}

	return true;
}

static void udp_burst_thread_fn(void *p1, void *p2, void *p3)
{
	ARG_UNUSED(p1);
	ARG_UNUSED(p2);
	ARG_UNUSED(p3);

	int sock;
	struct sockaddr_in bind_addr;
	uint8_t rx_buf[UDP_BURST_PAYLOAD_SIZE + 64];

	sock = zsock_socket(AF_INET, SOCK_DGRAM, IPPROTO_UDP);
	if (sock < 0) {
		printk("[UDP_BURST] Socket creation failed: %d\n", sock);
		udp_burst_running = false;
		return;
	}

	memset(&bind_addr, 0, sizeof(bind_addr));
	bind_addr.sin_family = AF_INET;
	bind_addr.sin_addr.s_addr = htonl(INADDR_ANY);
	bind_addr.sin_port = htons(UDP_BURST_PORT);

	if (zsock_bind(sock, (struct sockaddr *)&bind_addr, sizeof(bind_addr)) < 0) {
		printk("[UDP_BURST] Bind failed on port %d\n", UDP_BURST_PORT);
		zsock_close(sock);
		udp_burst_running = false;
		return;
	}

	printk("[UDP_BURST] Listening on UDP/%d, expected %d B packets, byte=0x%02x\n",
	       UDP_BURST_PORT, UDP_BURST_PAYLOAD_SIZE, UDP_BURST_EXPECT_BYTE);

	while (udp_burst_running) {
		int ret = zsock_recv(sock, rx_buf, sizeof(rx_buf), ZSOCK_MSG_DONTWAIT);

		if (ret > 0) {
			uint32_t now = (uint32_t)k_uptime_get_32();

			if (udp_rx_packets == 0) {
				udp_first_rx_ms = now;
			}
			udp_last_rx_ms = now;
			udp_rx_packets++;
			udp_rx_bytes += (uint32_t)ret;

			if (ret != UDP_BURST_PAYLOAD_SIZE) {
				udp_rx_bad_size++;
			} else if (!payload_is_expected(rx_buf, (size_t)ret)) {
				udp_rx_bad_payload++;
			}
			continue;
		}

		if (ret < 0 && errno != EAGAIN && errno != EWOULDBLOCK) {
			udp_rx_errors++;
		}

		k_sleep(K_MSEC(1));
	}

	zsock_close(sock);
	printk("[UDP_BURST] Stopped (RX: %u pkts, %llu bytes)\n", udp_rx_packets,
	       (unsigned long long)udp_rx_bytes);
}

int udp_flood_start(void)
{
	if (udp_burst_running) {
		return 0;
	}

	udp_rx_packets = 0;
	udp_rx_bad_size = 0;
	udp_rx_bad_payload = 0;
	udp_rx_errors = 0;
	udp_rx_bytes = 0;
	udp_first_rx_ms = 0;
	udp_last_rx_ms = 0;
	udp_burst_running = true;

	k_thread_create(&udp_burst_thread, udp_burst_stack, UDP_BURST_STACK_SIZE,
			udp_burst_thread_fn, NULL, NULL, NULL, UDP_BURST_PRIORITY, 0,
			K_NO_WAIT);
	k_thread_name_set(&udp_burst_thread, "udp_burst_rx");

	return 0;
}

void udp_flood_stop(void)
{
	if (!udp_burst_running) {
		return;
	}

	udp_burst_running = false;
	k_thread_join(&udp_burst_thread, K_SECONDS(5));
}

void udp_flood_report_stats(void)
{
	char buf[32];
	uint32_t span_ms = 0;

	if (udp_first_rx_ms != 0 && udp_last_rx_ms >= udp_first_rx_ms) {
		span_ms = udp_last_rx_ms - udp_first_rx_ms;
	}

	snprintf(buf, sizeof(buf), "%u", UDP_BURST_PORT);
	BENCH_META("udp_burst_port", buf);

	snprintf(buf, sizeof(buf), "%u", UDP_BURST_PAYLOAD_SIZE);
	BENCH_META("udp_burst_payload_bytes", buf);

	snprintf(buf, sizeof(buf), "0x%02x", UDP_BURST_EXPECT_BYTE);
	BENCH_META("udp_burst_expected_byte", buf);

	snprintf(buf, sizeof(buf), "%u", udp_rx_packets);
	BENCH_META("udp_rx_packets", buf);

	snprintf(buf, sizeof(buf), "%llu", (unsigned long long)udp_rx_bytes);
	BENCH_META("udp_rx_bytes", buf);

	snprintf(buf, sizeof(buf), "%u", udp_rx_bad_size);
	BENCH_META("udp_rx_bad_size", buf);

	snprintf(buf, sizeof(buf), "%u", udp_rx_bad_payload);
	BENCH_META("udp_rx_bad_payload", buf);

	snprintf(buf, sizeof(buf), "%u", udp_rx_errors);
	BENCH_META("udp_rx_errors", buf);

	snprintf(buf, sizeof(buf), "%u", span_ms);
	BENCH_META("udp_rx_span_ms", buf);
}
```

## src/udp_flood.h
```c
/*
 * Deterministic UDP-burst receiver for the RF-state WDEV benchmark.
 *
 * The host sends public, fixed-size UDP packets to the ESP32 while the
 * firmware streams raw WDEV bytes over UART.  This creates an AEB-like
 * gateway-to-DUT RF workload without mixing packet timing into the tested
 * WDEV byte stream.
 */

#ifndef UDP_FLOOD_H
#define UDP_FLOOD_H

#include <stdbool.h>
#include <stdint.h>

#ifndef UDP_BURST_PORT
#define UDP_BURST_PORT 9999
#endif

#ifndef UDP_BURST_PAYLOAD_SIZE
#define UDP_BURST_PAYLOAD_SIZE 64
#endif

#ifndef UDP_BURST_EXPECT_BYTE
#define UDP_BURST_EXPECT_BYTE 0x42
#endif

int udp_flood_start(void);
void udp_flood_stop(void);
void udp_flood_report_stats(void);

#endif /* UDP_FLOOD_H */
```

## src/wifi.c
```c
/*
 * esp32-rf-rng-state/src/wifi.c
 *
 * Copyright (C) 2024-2026 Javier Blanco-Romero @fj-blanco (UC3M, QURSA project)
 *
 * Wi-Fi management for the RF-TRNG benchmark.
 * Adapted from the QEaaS ESP32 client wolfSSL Wi-Fi helper.
 */

#include <errno.h>
#include <stdio.h>
#include <zephyr/net/net_event.h>
#include <zephyr/net/net_if.h>
#include <zephyr/net/socket.h>
#include <zephyr/net/wifi_mgmt.h>
#include <zephyr/net/wifi_utils.h>
#include "wifi.h"

#ifndef WIFI_SSID
#define WIFI_SSID "WIFI_SSID_NOT_SET"
#endif

#ifndef WIFI_PASS
#define WIFI_PASS "WIFI_PASS_NOT_SET"
#endif

#define WIFI_CONNECTION_TIMEOUT_MS 20000
#define WIFI_CONNECTION_ATTEMPTS   5
#define WIFI_RETRY_DELAY_MS        2000
#define WIFI_DHCP_TIMEOUT_MS       20000

struct wifi_connect_req_params wifi_params = {.ssid = WIFI_SSID,
					      .ssid_length = sizeof(WIFI_SSID) - 1,
					      .psk = WIFI_PASS,
					      .psk_length = sizeof(WIFI_PASS) - 1,
					      .band = WIFI_FREQ_BAND_2_4_GHZ,
					      .channel = WIFI_CHANNEL_ANY,
					      .security = WIFI_SECURITY_TYPE_PSK,
					      .mfp = WIFI_MFP_OPTIONAL,
					      .timeout = SYS_FOREVER_MS};

#define WIFI_SHELL_MGMT_EVENTS                                                                     \
	(NET_EVENT_WIFI_SCAN_RESULT | NET_EVENT_WIFI_SCAN_DONE | NET_EVENT_WIFI_CONNECT_RESULT |   \
	 NET_EVENT_WIFI_DISCONNECT_RESULT)

static union {
	struct {
		uint8_t connecting: 1;
		uint8_t disconnecting: 1;
		uint8_t _unused: 6;
	};
	uint8_t all;
} context;

static uint32_t scan_result;
static bool wifi_connected = false;
static bool wifi_event_logging = true;
static struct net_mgmt_event_callback wifi_event_cb;

static struct net_if *wifi_sta_iface(void)
{
	struct net_if *iface = net_if_get_wifi_sta();

	if (!iface) {
		printk("Failed to get Wi-Fi STA interface\n");
	}

	return iface;
}

static void handle_wifi_scan_result(struct net_mgmt_event_callback *cb)
{
	const struct wifi_scan_result *entry = (const struct wifi_scan_result *)cb->info;

	scan_result++;

	if (!wifi_event_logging) {
		return;
	}

	if (scan_result == 1) {
		printk("\n%-4s | %-32s %-5s | %-4s | %-4s | %-5s\n", "Num", "SSID", "(len)", "Chan",
		       "RSSI", "Sec");
	}

	printk("%-4d | %-32s %-5u | %-4u | %-4d | %-5s\n", scan_result, entry->ssid,
	       entry->ssid_length, entry->channel, entry->rssi,
	       (entry->security == WIFI_SECURITY_TYPE_PSK ? "WPA/WPA2" : "Open"));
}

static void handle_wifi_scan_done(struct net_mgmt_event_callback *cb)
{
	const struct wifi_status *status = (const struct wifi_status *)cb->info;

	if (status->status) {
		if (wifi_event_logging) {
			printk("\nWi-Fi scan request failed (%d)\n", status->status);
		}
	} else {
		if (wifi_event_logging) {
			printk("Wi-Fi scan done (%u results)\n", scan_result);
		}
	}
	scan_result = 0;
}

static void handle_wifi_connect_result(struct net_mgmt_event_callback *cb)
{
	const struct wifi_status *status = (const struct wifi_status *)cb->info;

	if (status->status) {
		if (wifi_event_logging) {
			printk("\nWi-Fi connection failed (%d)\n", status->status);
		}
	} else {
		if (wifi_event_logging) {
			printk("\nWi-Fi connected\n");
		}
		wifi_connected = true;
	}
	context.connecting = false;
}

static void handle_wifi_disconnect_result(struct net_mgmt_event_callback *cb)
{
	const struct wifi_status *status = (const struct wifi_status *)cb->info;

	wifi_connected = false;

	if (context.disconnecting) {
		if (wifi_event_logging) {
			printk("\nWi-Fi disconnection %s (%d)\n",
			       status->status ? "failed" : "done", status->status);
		}
		context.disconnecting = false;
	} else {
		if (wifi_event_logging) {
			printk("\nWi-Fi Disconnected\n");
		}
	}
}

void wifi_set_event_logging(bool enabled)
{
	wifi_event_logging = enabled;
}

bool wifi_event_logging_enabled(void)
{
	return wifi_event_logging;
}

bool wifi_is_connected(void)
{
	return wifi_connected;
}

static bool wifi_has_ipv4(void)
{
	struct net_if *iface = wifi_sta_iface();

	if (!iface || !iface->config.ip.ipv4) {
		return false;
	}

	for (int i = 0; i < NET_IF_MAX_IPV4_ADDR; i++) {
		struct net_if_addr *ifaddr = &iface->config.ip.ipv4->unicast[i].ipv4;

		if (!ifaddr->is_used || ifaddr->addr_type == NET_ADDR_ANY ||
		    ifaddr->address.family != AF_INET) {
			continue;
		}

		return true;
	}

	return false;
}

int wifi_wait_for_ipv4(int timeout_ms)
{
	int waited_ms = 0;

	while (!wifi_has_ipv4() && waited_ms < timeout_ms) {
		k_sleep(K_MSEC(250));
		waited_ms += 250;
	}

	if (!wifi_has_ipv4()) {
		printk("[RF_WIFI] IPv4 timeout after %d ms\n", waited_ms);
		return -ETIMEDOUT;
	}

	wifi_print_ipv4();
	return 0;
}

void wifi_mgmt_event_handler(struct net_mgmt_event_callback *cb, uint32_t mgmt_event,
			     struct net_if *iface)
{
	switch (mgmt_event) {
	case NET_EVENT_WIFI_SCAN_RESULT:
		handle_wifi_scan_result(cb);
		break;
	case NET_EVENT_WIFI_SCAN_DONE:
		handle_wifi_scan_done(cb);
		break;
	case NET_EVENT_WIFI_CONNECT_RESULT:
		handle_wifi_connect_result(cb);
		break;
	case NET_EVENT_WIFI_DISCONNECT_RESULT:
		handle_wifi_disconnect_result(cb);
		break;
	default:
		break;
	}
}

int wifi_init(struct device *unused)
{
	ARG_UNUSED(unused);

	context.all = 0;
	scan_result = 0;

	net_mgmt_init_event_callback(&wifi_event_cb, wifi_mgmt_event_handler,
				     WIFI_SHELL_MGMT_EVENTS);

	printk("Wi-Fi event callback initialized\n");
	net_mgmt_add_event_callback(&wifi_event_cb);

	return 0;
}

int wait_for_wifi_connection(void)
{
	int timeout_count = 0;
	int max_timeout_count = WIFI_CONNECTION_TIMEOUT_MS / 100;

	while (!wifi_connected) {
		k_sleep(K_MSEC(100));
		timeout_count++;

		if (timeout_count >= max_timeout_count) {
			printk("Wi-Fi connection timeout after %d ms\n",
			       WIFI_CONNECTION_TIMEOUT_MS);
			return -ETIMEDOUT;
		}
	}

	printk("Wi-Fi connected successfully\n");
	return 0;
}

int connect_to_wifi(void)
{
	int last_ret = -ETIMEDOUT;

	struct net_if *iface = wifi_sta_iface();

	if (!iface) {
		return -ENODEV;
	}

	for (int attempt = 1; attempt <= WIFI_CONNECTION_ATTEMPTS; attempt++) {
		int ret;

		wifi_connected = false;
		context.connecting = true;

		printk("Connecting to Wi-Fi (attempt %d/%d, ssid=%s)...\n", attempt,
		       WIFI_CONNECTION_ATTEMPTS, WIFI_SSID);

		ret = net_mgmt(NET_REQUEST_WIFI_CONNECT, iface, &wifi_params,
			       sizeof(struct wifi_connect_req_params));

		if (ret < 0) {
			printk("Failed to request Wi-Fi connection: %d\n", ret);
			context.connecting = false;
			last_ret = ret;
		} else {
			printk("Wi-Fi connection requested\n");
			ret = wait_for_wifi_connection();
			if (ret == 0) {
				ret = wifi_wait_for_ipv4(WIFI_DHCP_TIMEOUT_MS);
				if (ret == 0) {
					return 0;
				}
			}
			last_ret = ret;
		}

		wifi_disconnect();
		k_sleep(K_MSEC(WIFI_RETRY_DELAY_MS));
	}

	printk("Wi-Fi failed after %d attempts\n", WIFI_CONNECTION_ATTEMPTS);
	return last_ret;
}

int wifi_reconnect(void)
{
	if (wifi_connected) {
		return 0;
	}

	printk("[WIFI] Reconnecting...\n");
	wifi_disconnect();
	k_sleep(K_MSEC(WIFI_RETRY_DELAY_MS));

	return connect_to_wifi();
}

void wifi_disconnect(void)
{
	struct net_if *iface = wifi_sta_iface();

	if (!iface) {
		return;
	}

	context.disconnecting = true;

	if (net_mgmt(NET_REQUEST_WIFI_DISCONNECT, iface, NULL, 0)) {
		printk("Wi-Fi disconnect failed\n");
		context.disconnecting = false;
	} else {
		printk("Wi-Fi disconnect requested\n");
	}
}

int wifi_trigger_scan(void)
{
	struct net_if *iface = wifi_sta_iface();

	if (!iface) {
		return -ENODEV;
	}

	if (net_mgmt(NET_REQUEST_WIFI_SCAN, iface, NULL, 0)) {
		printk("Wi-Fi scan request failed\n");
		return -1;
	}
	return 0;
}

void wifi_print_ipv4(void)
{
	struct net_if *iface = wifi_sta_iface();

	if (!iface || !iface->config.ip.ipv4) {
		return;
	}

	for (int i = 0; i < NET_IF_MAX_IPV4_ADDR; i++) {
		struct net_if_addr *ifaddr = &iface->config.ip.ipv4->unicast[i].ipv4;
		char buf[NET_IPV4_ADDR_LEN];

		if (!ifaddr->is_used || ifaddr->addr_type == NET_ADDR_ANY ||
		    ifaddr->address.family != AF_INET) {
			continue;
		}

		net_addr_ntop(AF_INET, &ifaddr->address.in_addr, buf, sizeof(buf));
		printk("[RF_WIFI] IPv4 %s\n", buf);
	}
}
```

## src/wifi.h
```c
/*
 * esp32-rf-rng-state/src/wifi.h
 *
 * Copyright (C) 2024-2026 Javier Blanco-Romero @fj-blanco (UC3M, QURSA project)
 *
 * Wi-Fi management header for the RF-TRNG benchmark.
 * Adapted from the QEaaS ESP32 client wolfSSL Wi-Fi helper.
 */

#ifndef WIFI_H
#define WIFI_H

#include <zephyr/kernel.h>
#include <zephyr/net/net_if.h>
#include <zephyr/net/wifi_mgmt.h>

extern struct wifi_connect_req_params wifi_params;

void wifi_mgmt_event_handler(struct net_mgmt_event_callback *cb, uint32_t mgmt_event,
			     struct net_if *iface);
int wifi_init(struct device *unused);
int shell_cmd_scan(void);
int wait_for_wifi_connection(void);
int wifi_wait_for_ipv4(int timeout_ms);
int connect_to_wifi(void);
int wifi_reconnect(void);
void wifi_disconnect(void);
bool wifi_is_connected(void);
void wifi_set_event_logging(bool enabled);
bool wifi_event_logging_enabled(void);
void wifi_print_ipv4(void);

/**
 * Trigger a Wi-Fi scan (non-blocking).
 * Used by the wifi_scan condition to generate RF activity
 * without application-layer data transfer.
 */
int wifi_trigger_scan(void);

#endif /* WIFI_H */
```
